## drivers/video/fbdev/msm/Kconfig
```kconfig
source "drivers/video/fbdev/msm/msm_dba/Kconfig"

if FB_MSM

config FB_MSM_MDSS_COMMON
	bool

choice
	prompt "MDP HW version"
	default FB_MSM_MDP

config FB_MSM_MDP
	bool "MDP HW"
	select FB_MSM_MDP_HW
	---help---
	The Mobile Display Processor (MDP) driver support devices which
	contain MDP hardware block.

	Support for MSM MDP HW revision 2.2.
	Say Y here if this is msm7201 variant platform.

config FB_MSM_MDSS
	bool "MDSS HW"
	select SYNC_FILE
	select FB_MSM_MDSS_COMMON
	---help---
	The Mobile Display Sub System (MDSS) driver supports devices which
	contain MDSS hardware block.

	The MDSS driver implements frame buffer interface to provide access to
	the display hardware and provide a way for users to display graphics
	on connected display panels.

config FB_MSM_MDP_NONE
	bool "MDP HW None"
	---help---
	This is used for platforms without Mobile Display Sub System (MDSS).
	mdm platform don't have MDSS hardware block.

	Say Y here if this is mdm platform.

endchoice

config FB_MSM_QPIC
	bool
	select FB_MSM_MDSS_COMMON

config FB_MSM_QPIC_ILI_QVGA_PANEL
	bool "Qpic MIPI ILI QVGA Panel"
	select FB_MSM_QPIC
	---help---
	Support for MIPI ILI QVGA (240x320) panel ILI TECHNOLOGY 9341
	with on-chip full display RAM use parallel interface.

config FB_MSM_QPIC_PANEL_DETECT
	bool "Qpic Panel Detect"
	select FB_MSM_QPIC_ILI_QVGA_PANEL
	---help---
	Support for Qpic panel auto detect.

config FB_MSM_MDSS_WRITEBACK
	bool "MDSS Writeback Panel"
	---help---
	The MDSS Writeback Panel provides support for routing the output of
	MDSS frame buffer driver and MDP processing to memory.

config FB_MSM_MDSS_HDMI_PANEL
	bool "MDSS HDMI Tx Panel"
	depends on FB_MSM_MDSS
	select MSM_EXT_DISPLAY
	default n
	---help---
	The MDSS HDMI Panel provides support for transmitting TMDS signals of
	MDSS frame buffer data to connected hdmi compliant TVs, monitors etc.

config FB_MSM_MDSS_HDMI_MHL_SII8334
	depends on FB_MSM_MDSS_HDMI_PANEL
	bool 'MHL SII8334 support '
	default n
	---help---
	Support the HDMI to MHL conversion.
	MHL (Mobile High-Definition Link) technology
	uses USB connector to output HDMI content

config FB_MSM_MDSS_SPI_PANEL
        depends on FB_MSM_MDSS
        bool "Support SPI panel feature"
        default n
        ---help---
        The MDSS SPI Panel provides support for transmittimg SPI signals of
        MDSS frame buffer data to connected panel. Limited by SPI rate, the
        current max fps only reach to 27 fps, and limited by MDP hardware
        architecture only supply on MDP3

config FB_MSM_MDSS_MHL3
	depends on FB_MSM_MDSS_HDMI_PANEL
	bool "MHL3 SII8620 Support"
	default n
	---help---
	Support the SiliconImage 8620 MHL Tx transmitter that uses
	USB connector to output HDMI content. Transmitter is an
	i2c device acting as an HDMI to MHL bridge. Chip supports
	MHL 3.0 standard.

config FB_MSM_MDSS_DSI_CTRL_STATUS
	tristate "DSI controller status check feature"
	---help---
	Check DSI controller status periodically (default period is 5
	seconds) by sending Bus-Turn-Around (BTA) command. If DSI controller
	fails to acknowledge the BTA command, it sends PANEL_ALIVE=0 status
	to HAL layer to reset the controller.

config FB_MSM_MDSS_EDP_PANEL
	depends on FB_MSM_MDSS
	bool "MDSS eDP Panel"
	---help---
	The MDSS eDP Panel provides support for eDP host controller driver.
	Which runs in Video mode only and is responsible for transmitting
	frame buffer from host SOC to eDP display panel.

config FB_MSM_MDSS_MDP3
	depends on FB_MSM_MDSS
	bool "MDP3 display controller"
	---help---
	The MDP3 provides support for an older version display controller.
	Included in latest display sub-system, known as MDSS.

config FB_MSM_MDSS_XLOG_DEBUG
	depends on FB_MSM_MDSS
	bool "Enable MDSS debugging"
	---help---
	The MDSS debugging provides support to enable display debugging
	features to: Dump MDSS registers during driver errors, panic
	driver during fatal errors and enable some display-driver logging
	into an internal buffer (this avoids logging overhead).

config FB_MSM_MDSS_FRC_DEBUG
	depends on DEBUG_FS && FB_MSM_MDSS
	bool "Enable Video FRC debugging"
	default n
	---help---
	The MDSS FRC debugging provides support to enable the deterministic
	frame rate control (FRC) debugging features to: Collect video frame
	statistics and check whether its output pattern matches expected
	cadence.

config LGE_DISPLAY_P2S_VSYNC_SKIP
	bool "MDSS VSYNC Skip scheme"
	default n
	---help---
	This feature provides VSYNC skip scheme.

config LGE_DISPLAY_COMMON
	depends on FB_MSM_MDSS
	bool "Use LGE DISPLAY COMMON"
	---help---
	The LGE DISPLAY COMMON provides support for common display features
	made by LGE.

config LGE_DISPLAY_OVERRIDE_MDSS_DSI_CTRL_SHUTDOWN
	depends on LGE_DISPLAY_COMMON
	bool "Use OVERRIDE MDSS_DSI_CTRL_SHUTDOWN"
	---help---
	It provides support for
	ovrriding mdss_dsi_ctrl_shutdown() function.

config LGE_DISPLAY_OVERRIDE_MDSS_DSI_PANEL_RESET
	depends on LGE_DISPLAY_COMMON
	bool "Use OVERRIDE MDSS_DSI_PANEL_RESET"
	---help---
	It provides support for
	ovrriding mdss_dsi_panel_reset() function.

config LGE_DISPLAY_OVERRIDE_MDSS_DSI_PANEL_ON
	depends on LGE_DISPLAY_COMMON
	bool "Use OVERRIDE MDSS_DSI_PANEL_ON"
	---help---
	It provides support for
	ovrriding mdss_dsi_panel_on() function.

config LGE_DISPLAY_OVERRIDE_MDSS_DSI_PANEL_OFF
	depends on LGE_DISPLAY_COMMON
	bool "Use OVERRIDE MDSS_DSI_PANEL_OFF"
	---help---
	It provides support for
	ovrriding mdss_dsi_panel_off() function.

config LGE_DISPLAY_OVERRIDE_MDSS_DSI_PANEL_POWER_OFF
	depends on LGE_DISPLAY_COMMON
	bool "Use OVERRIDE MDSS_DSI_PANEL_POWER_OFF"
	---help---
	It provides support for
	ovrriding mdss_dsi_panel_power_off() function.

config LGE_DISPLAY_OVERRIDE_MDSS_DSI_PANEL_POWER_ON
	depends on LGE_DISPLAY_COMMON
	bool "Use OVERRIDE MDSS_DSI_PANEL_POWER_ON"
	---help---
	It provides support for
	ovrriding mdss_dsi_panel_power_on() function.

config LGE_DISPLAY_TOUCH_NOTIFIER_CALL_CHAIN
	depends on LGE_DISPLAY_COMMON
	bool "Use TOUCH_NOTIFIER_CALL_CHAIN"
	---help---
	It provides support for
	calling touch_notifier_call_chain() function.

config LGE_DISPLAY_CV7A
	depends on LGE_DISPLAY_COMMON
	bool "Use LGE DISPLAY CV7A"
	---help---
    It provides support for CV7A panel

config LGE_DISPLAY_MH4
	depends on LGE_DISPLAY_COMMON
	bool "Use LGE DISPLAY MH4"
	---help---
    It provides support for MH4 panel

config LGE_DISPLAY_MH5LM
	depends on LGE_DISPLAY_COMMON
	bool "Use LGE DISPLAY MH5LM"
	---help---
    It provides support for MH5LM panel

config LGE_DISPLAY_MH3J
	depends on LGE_DISPLAY_COMMON
	bool "Use LGE DISPLAY MH3J"
	---help---
    It provides support for MH3J panel

config LGE_DISPLAY_BL_USE_BLMAP
	depends on FB_MSM_MDSS
	bool "Use LGE BLMAP"
	---help---
	To get backlight level from backlight value[0~255],
	It uses backlight map, instead of linear function.

config LGE_DISPLAY_READER_MODE
	depends on FB_MSM_MDSS
	bool "LGE reader mode"
	---help---
	The reader mode provides support to change color temperature
	by sending proper cmds to panel.

config LGE_DISPLAY_COMFORT_MODE
	depends on FB_MSM_MDSS
	bool "LGE comfort view"
	---help---
	The comfort mode provides support to change color temperature
	by sending proper cmds to panel.

config LGE_DISPLAY_RECOVERY
	bool "Enable a function for report panel dead"
	default n

config LGE_LCD_ESD_PANEL_POWER_RECOVERY
	bool "Enable a function for report panel dead"
	default n

config LGE_DISPLAY_WITH_QCT_ESD
        depends on LGE_DISPLAY_RECOVERY_ESD
        bool "Use DISPLAY_WITH_QCT_ESD"
        ---help---
        It provides ESD Recovery with QCT recovery

config LGE_DISPLAY_ESD_NOT_CHECK_WITH_FACTORY_CABLE
	bool "ESD check disable when factory cable boot"
	default n

config LGE_DISPLAY_MFTS
	depends on FB_MSM_MDSS
	bool "LGE display MFTS"
	---help---
	MFTS provides support panel power sequence in MFTS MODE.

config LGE_DISPLAY_BL_DIMMING
	bool "Enable LCD DIMMING for FOTA"
	default n
	---help---
	Support for LCD DIMMING (for FOTA)

config LGE_DISPLAY_BL_SP_MIRRORING
	bool "SP_MIRRORING_CTRL_BL"
	default n
	select MACH_LGE
	help
	if you say yes here you get support for sp mirroring backlight control

config LGE_DISPLAY_DEBUG
	bool "DISPLAY_DEBUG"
	default n
	select MACH_LGE
	help
	if you say yes here you get support for display debug

config LGE_DISPLAY_HT_LCD_TUNE_MODE
	bool "LGE_DISPLAY_HT_LCD_TUNE_MODE"
	default n
	help
	if you say yes here you get support for high temperature lcd tune.

config LGE_INTERVAL_MONITOR
	depends on LGE_DISPLAY_COMMON
	bool "Frame Interval Monitor"
	---help---
	This feature provides Frame Interval Monitor scheme.

config LGE_FBCN
	depends on LGE_DISPLAY_COMMON
	bool "Frame Based Clock Normalizer"
	---help---
	This feature provides Frame Based Clock Normalizer scheme.

config LGE_DISPLAY_COLOR_MANAGER
	bool "Enable LGE_DISPLAY_COLOR_MANAGER"
	default n

config PXLW_IRIS3
	depends on FB_MSM_MDSS
	bool "Enable pxlw iris3"

config LGE_DISPLAY_DDIC_TD4310
	depends on FB_MSM_MDSS
	bool "Enable supprot for Synaptics TD4310"
endif
```

## drivers/video/slimport/Kconfig
```kconfig
source "drivers/video/slimport/anx7580/Kconfig"
source "drivers/video/slimport/anx7625/Kconfig"

config SLIMPORT_COMMON
    tristate "Analogix Slimport transmitter ANX support"
    help
      Slimport Transmitter is a video transmitter chip
      over micro-USB connector for smartphone device.
```

## drivers/video/slimport/anx7580/Kconfig
```kconfig
config SLIMPORT_ANX7580
	tristate "Analogix Slimport transmitter ANX7580 support"
	help
	  Slimport Transmitter is a HD video transmitter chip over micro-USB connector for smartphone device.
```

## drivers/video/slimport/anx7625/Kconfig
```kconfig
config SLIMPORT_ANX7625
	tristate "Analogix Slimport transmitter ANX7625 support"
	help
	  Slimport Transmitter is a HD video transmitter chip over micro-USB connector for smartphone device.
```
