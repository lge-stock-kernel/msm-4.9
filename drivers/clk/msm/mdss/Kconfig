## drivers/clk/msm/mdss/Kconfig
```kconfig
config MSM_MDSS_PLL
	bool "MDSS pll programming"
	---help---
	It provides support for DSI, eDP and HDMI interface pll programming on MDSS
	hardware. It also handles the pll specific resources and turn them on/off when
	mdss pll client tries to enable/disable pll clocks.

config LGE_DISPLAY_COMMON
	depends on MSM_MDSS_PLL
	bool "Use LGE DISPLAY COMMON"
	---help---
	The LGE DISPLAY COMMON provides support for common display features
	made by LGE.
```

## drivers/input/fingerprint/Kconfig
```kconfig
#
# Fingerprints driver configuration
#
menuconfig INPUT_FINGERPRINT
	bool "FingerPrints"
	help
	  Say Y here, and a list of supported fingerprints will be displayed.
	  This option doesn't affect the kernel.

	  If unsure, say Y.

if INPUT_FINGERPRINT

config INPUT_FPC1511
        tristate "FPC1511 fingerprint sensor support"
        depends on SPI_MASTER

config INPUT_FPC1035_DUAL
        tristate "FPC1035 dual fingerprint sensor support"
        depends on SPI_MASTER

config FINGERPRINT_FPS998E_ZQL1606
	tristate "FPS998E_ZQL1628"
	depends on SPI
	help
	  Say Y here if you have a 88PM860x PMIC and want to enable
	  support for the built-in touchscreen.

	  If unsure, say N.

	  To compile this driver as a module, choose M here: the
	  module will be called 88pm860x-ts

if FINGERPRINT_FPS998E_ZQL1606
config FINGERPRINT_FPS998E_ZQL1606_ID_HI
	bool "fp id pin is high"
config FINGERPRINT_FPS998E_ZQL1606_ID_LO
	bool "fp id pin is low"
endif

if INPUT_FPC1035_DUAL
config FINGERPRINT_FPC1035_ID_HI
	bool "fp id pin is high"
config FINGERPRINT_FPC1035_ID_LO
	bool "fp id pin is low"
endif

endif
```

## drivers/input/touchscreen/lge/focaltech/Kconfig
```kconfig
#
# LGE touch core configuration
#
if INPUT_TOUCHSCREEN
source "drivers/input/touchscreen/lge/focaltech/ft5446/Kconfig"
endif
```

## drivers/input/touchscreen/lge/lgsic/Kconfig
```kconfig
#
# LGE touch core configuration
#
if INPUT_TOUCHSCREEN

menuconfig LGE_TOUCH_LGSIC_SW49107
	bool "LGE Touch Core ODM Device Driver - SW49107"
	depends on LGE_TOUCH_CORE_BASE
	help
	  If your device is sw49107, say Y
endif
```

## drivers/input/touchscreen/lge/synaptics/Kconfig
```kconfig
#
# LGE touch core configuration
#

if INPUT_TOUCHSCREEN

menuconfig LGE_TOUCH_SYNAPTICS_TD4310
	bool "LGE Touch Core ODM Device Driver - Synaptics(td4310)"
	depends on LGE_TOUCH_CORE_BASE
	help
	  If your device is synaptics(td4310), say Y

endif
```

## drivers/input/touchscreen/melfas_mip4/Kconfig
```kconfig
#
# Kconfig for MELFAS MIP4 Touchscreen Driver
#

if INPUT_TOUCHSCREEN

config TOUCHSCREEN_MELFAS_MIT410
	tristate "MELFAS MIT410 Touchscreen"
	depends on I2C
	help
	  Say Y here if you have a MELFAS MIT410 touchscreen device in your system.

	  If unsure, say N.

	  To compile this driver as a module, choose M here: the module will be called melfas_mip4_ts.

endif
```

## drivers/power/supply/lge/Kconfig
```kconfig
config LGE_PM_VENEER_PSY
	bool "Apply LGE veneer psy"
	depends on LGE_PM
	default n
	help
	  Say Y here enable support lge veneer psy

config LGE_PM_CCD
	bool "support Charging Control Daemon"
	depends on LGE_PM
	default n
	help
	  Say Y to using Charging Control Daemon(CCD)

config LGE_PM_QNOVO_QNS
	bool "QNOVO QNS driver"
	default n
	help
	  Say Y here to enable the QNS engine. Qnovo driver
	  accepts pulse parameters via sysfs entries and programs.
	  It also allows userspace code to read diagnostics of voltage
	  and current measured during certain phases of the pulses.

config LGE_PM_BRINGUP
	bool "support LGE PM Bringup"
	depends on LGE_PM
	default n
	help
	  Say Y to using LGE PM Bringup

config LGE_PM_BATTID_REDETECTION
	bool "Apply battery id re-detection"
	depends on LGE_PM_VENEER_PSY
	default n
	help
	  Say Y here enable support battery re-detection

config LGE_PM_USBID_RE_READ
	bool "Apply USB id re-read"
	depends on LGE_PM_VENEER_PSY
	default n
	help
	  Say Y here enable USB ID re-read

config LGE_PM_LAOP_ATT_CRK_SIM_BASED_SWITCHING
	bool "Apply ATT-CRK SIM BASED Operator Swiching"
	depends on LGE_PM_VENEER_PSY
	default n
	help
	  Say Y to here enable support floated charger & slow charger detection by ATT-CRK SIM BASED Operator Swiching

config LGE_PM_INBOX_TA_AICL_WA
	bool "Apply INBOX_TA_AICL_WA"
	depends on LGE_PM_VENEER_PSY
	default n
	help
	  Say Y to here enable support inbox ta aicl W/A
```

## drivers/soc/qcom/lge/Kconfig
```kconfig
config MACH_LGE
	bool "Machine LGE"
	help
	  Support for machine LGE.

menu "LGE Board Selection"

config MACH_SDM450_CV7AS
	bool "SDM450 CV7AS"
	depends on ARCH_SDM450
	select MACH_LGE
	select LGE_DM_VERITY_RECOVERY
	help
	  Support for the Qualcomm SDM450 CV7AS device.

config MACH_SDM450_MH4X
	bool "SDM450 MH4X"
	depends on ARCH_SDM450
	select MACH_LGE
	select LGE_DM_VERITY_RECOVERY
	help
	  Support for the Qualcomm SDM450 MH4X device.
      
config MACH_SDM450_MH3J
	bool "SDM450 MH3J"
	depends on ARCH_SDM450
	select MACH_LGE
	select LGE_DM_VERITY_RECOVERY
	help
	  Support for the Qualcomm SDM450 MH3J device.

config MACH_MSM8917_MH5LM
	bool "MSM8917 MH5LM"
	depends on ARCH_MSM8917
	help
	  Support for the Qualcomm MSM8917 MH5LM device.

config MACH_MSM8917_MH5LM_NONAB
	bool "MSM8917 MH5LM NONAB"
	depends on ARCH_MSM8917
	help
	  Support for the Qualcomm MSM8917 MH5LM device.

endmenu

menu "LGE Specific Patches"

config LGE_HANDLE_PANIC
       tristate "Support LGE Crash Handler"
       default n
       depends on MACH_LGE
       help
         LGE Crash Handler

config LGE_QSDL_SUPPORT
    tristate "Support for Quality Statistics Data Logging"
	default n
	depends on MACH_LGE
	help
	  QSDL is a feature which notify infomation for quality statistics data logging of device.

config LGE_BOOTLOADER_LOG
	tristate "Support LGE bootloader log"
	default n
	depends on MACH_LGE
	help
	  LGE bootloader log

config LGE_BOOTLOADER_TIME_CHECKER
	tristate "Supprt bootloader(LK, SBL) time"
	default n
	depends on MACH_LGE
	help
	  Check LK, SBL booting time at
	  sys/module/lge_bootloader_time_checker/parameters/lk_time
	  sys/module/lge_bootloader_time_checker/parameters/sbl_time

config LGE_USE_DEFAULT_HARD_RESET
	bool "On reboot, apply hard reset unless memory contents must be maintained"
	default n
	help
	  Nobody can guarantee stablity upon continuous warm resets.

config LGE_PM
	tristate "Support LGE power-management"
	default n
	depends on MACH_LGE
	help
	  Global feature of LGE power-management

config LGE_PM_DEBUG
	tristate "Support LGE PM Debug Feature"
	default n
	depends on MACH_LGE
	help
	  LGE PM Debug Feature

config LGE_PM_SMPL_COUNTER
	tristate "Support LGE SMPL COUNTER feature"
	default n
	depends on MACH_LGE
	help
	  Say y to enable smpl_cnt module, that count when
	  booted by SMPL.

config LGE_PM_WAKE_LOCK_FOR_CHG_LOGO
	bool "Wakelocks for LGE Chargerlogo"
	depends on LGE_PM
	help
	  It enables wakelocks for LGE Chargerlogo.

config LGE_ONE_BINARY_SKU
        tristate "Support LGE One binary sku carrier"
	default n
	depends on MACH_LGE
	help
	  LGE One Binary sku carrier.

config LGE_DM_VERITY_RECOVERY
	tristate "Support dm verity corrupt recovery"
	default n
	depends on MACH_LGE
	help
	  Sometimes, dm-bufio has invalid data. If data is corrupted,
	  try to recover data.

endmenu

menu "LGE QFPROM Values"

config LGE_QFPROM_INTERFACE
	bool "Support qfprom interface"
	default n
	depends on MACH_LGE
	help
	  LGE QFPROM DRIVER.

endmenu
```
