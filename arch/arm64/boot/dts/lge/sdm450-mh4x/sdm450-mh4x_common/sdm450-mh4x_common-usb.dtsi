/*
 * Copyright (c) 2018, The Linux Foundation. All rights reserved.
 *
 * This program is free software; you can redistribute it and/or modify
 * it under the terms of the GNU General Public License version 2 and
 * only version 2 as published by the Free Software Foundation.
 *
 * This program is distributed in the hope that it will be useful,
 * but WITHOUT ANY WARRANTY; without even the implied warranty of
 * MERCHANTABILITY or FITNESS FOR A PARTICULAR PURPOSE.  See the
 * GNU General Public License for more details.
 */

&usb3 {
        qcom,dwc-vadc = <&pmi632_vadc>;
        qcom,usbin-vadc = <&pmi632_vadc>;
        qcom,dwc-adc_tm = <&pmi632_adc_tm>;
};

&pm8953_typec {
	status = "disabled";
};

&pmi632_vadc {
	interrupts = <0x2 0x31 0x0 IRQ_TYPE_EDGE_RISING>,
			<0x2 0x31 0x3 IRQ_TYPE_EDGE_RISING>,
			<0x2 0x31 0x4 IRQ_TYPE_EDGE_RISING>;
	interrupt-names = "eoc-int-en-set",
			"high-thr-en-set",
			"low-thr-en-set";
	qcom,vadc-meas-int-mode;
};