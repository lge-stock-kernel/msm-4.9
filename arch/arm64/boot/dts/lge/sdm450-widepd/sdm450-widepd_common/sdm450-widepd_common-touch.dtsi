/*
 * Copyright (c) 2018, The Linux Foundation. All rights reserved.
 *
 * This program is free software; you can redistribute it and/or modify
 * it under the terms of the GNU General Public License version 2 and
 * only version 2 as published by the Free Software Foundation.
 *
 * This program is distributed in the hope that it will be useful,
 * but WITHOUT ANY WARRANTY; without even the implied warranty of
 * MERCHANTABILITY or FITNESS FOR A PARTICULAR PURPOSE.  See the
 * GNU General Public License for more details.
 */

 &i2c_3 { /* BLSP1 QUP3 */

	status = "okay";
	qcom,clk-freq-out = <400000>;

	melfas_mip4_ts@34 {
		compatible = "melfas,mip4_ts";
		status = "okay";
		reg = <0x34>;
		interrupt-parent = <&tlmm>;
		interrupts = <65 0x0>;
		vd33-supply = <&pm8953_l22>;
		pinctrl-names = "enable", "disable";
		pinctrl-0 = <&ts_reset_active>;
		pinctrl-1 = <&ts_reset_suspend>;
		irq-gpio = <&tlmm 65 0x0>;
	};
};
