/*
 * Copyright (c) 2018, The Linux Foundation. All rights reserved.
 *
 * This program is free software; you can redistribute it and/or modify
 * it under the terms of the GNU General Public License version 2 and
 * only version 2 as published by the Free Software Foundation.
 *
 * This program is distributed in the hope that it will be useful,
 * but WITHOUT ANY WARRANTY; without even the implied warranty of
 * MERCHANTABILITY or FITNESS FOR A PARTICULAR PURPOSE.  See the
 * GNU General Public License for more details.
 */

#include "../../dsi-panel-lgd-incell-sw49107-fhd-command-sdm450.dtsi"
#include "../../dsi-panel-lgd-incell-sw49107-fhd-command-sdm450_rev1.dtsi"
#include "../../dsi-panel-tovis-incell-sw49107-fhd-command-sdm450.dtsi"
#include "../../dsi-panel-tovis-incell-sw49107-fhd-command-sdm450_rev1.dtsi"
#include "../../ext_dsv_dw8768_cv7as.dtsi"
#include "../../ext_backlight_lm3697_cv7as.dtsi"
