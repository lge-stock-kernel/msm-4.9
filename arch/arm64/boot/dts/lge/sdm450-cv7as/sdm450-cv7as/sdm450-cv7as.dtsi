/*
 * Copyright (c) 2018, The Linux Foundation. All rights reserved.
 *
 * This program is free software; you can redistribute it and/or modify
 * it under the terms of the GNU General Public License version 2 and
 * only version 2 as published by the Free Software Foundation.
 *
 * This program is distributed in the hope that it will be useful,
 * but WITHOUT ANY WARRANTY; without even the implied warranty of
 * MERCHANTABILITY or FITNESS FOR A PARTICULAR PURPOSE.  See the
 * GNU General Public License for more details.
 */

#include <dt-bindings/gpio/gpio.h>
#include <dt-bindings/clock/msm-clocks-8953.h>

#include "../sdm450-cv7as_common/sdm450-cv7as_common.dtsi"
#include "sdm450-cv7as-camera.dtsi"
#include "sdm450-cv7as-pinctrl.dtsi"
#include "sdm450-cv7as-panel.dtsi"
#include "sdm450-cv7as-misc.dtsi"
#include "sdm450-cv7as-pm.dtsi"
#include "sdm450-cv7as-sound.dtsi"
#include "sdm450-cv7as-connectivity.dtsi"
#include "sdm450-cv7as-nfc.dtsi"
#include "sdm450-cv7as-tdmb.dtsi"
#include "sdm450-cv7as-touch.dtsi"
#include "sdm450-cv7as-fingerprint.dtsi"
#include "sdm450-cv7as-sensor.dtsi"
#include "sdm450-cv7as-usb.dtsi"
