/* Copyright (c) 2014, Code Aurora Forum. All rights reserved.
 *
 * This program is free software; you can redistribute it and/or modify
 * it under the terms of the GNU General Public License version 2 and
 * only version 2 as published by the Free Software Foundation.
 *
 * This program is distributed in the hope that it will be useful,
 * but WITHOUT ANY WARRANTY; without even the implied warranty of
 * MERCHANTABILITY or FITNESS FOR A PARTICULAR PURPOSE.  See the
 * GNU General Public License for more details.
 */

&mdss_mdp {
	dsi_tovis_incell_sw49107_fhd_incell_cmd_rev1: qcom,mdss_dsi_tovis_incell_sw49107_fhd_command_rev1{
		compatible = "qcom,mdss-dsi-panel";
		status = "ok";
		qcom,cont-splash-enabled;
		qcom,mdss-dsi-panel-name = "TOVIS INCELL SW49107 FHD command mode dsi panel";
		qcom,mdss-dsi-panel-controller = <&mdss_dsi0>;
		qcom,mdss-dsi-panel-type = "dsi_cmd_mode";
		qcom,mdss-dsi-panel-destination = "display_1";
		qcom,mdss-dsi-panel-framerate = <60>;
		qcom,mdss-dsi-virtual-channel-id = <0>;
		qcom,mdss-dsi-stream = <0>;
		qcom,mdss-dsi-lp11-init;
		qcom,mdss-dsi-panel-width = <1080>;
		qcom,mdss-dsi-panel-height = <2160>;
		qcom,mdss-dsi-h-front-porch = <20>;
		qcom,mdss-dsi-h-back-porch = <24>;
		qcom,mdss-dsi-h-pulse-width = <4>;
		qcom,mdss-dsi-h-sync-skew = <0>;
		qcom,mdss-dsi-v-front-porch = <116>;
		qcom,mdss-dsi-v-back-porch = <116>;
		qcom,mdss-dsi-v-pulse-width = <1>;
		qcom,mdss-dsi-h-left-border = <0>;
		qcom,mdss-dsi-h-right-border = <0>;
		qcom,mdss-dsi-v-top-border = <0>;
		qcom,mdss-dsi-v-bottom-border = <0>;

		qcom,mdss-pan-physical-width-dimension = <70>;
		qcom,mdss-pan-physical-height-dimension = <140>;

		qcom,mdss-dsi-bpp = <24>;
		qcom,mdss-dsi-color-order = "rgb_swap_rgb";
		qcom,mdss-dsi-underflow-color = <0xFF>;
		qcom,mdss-dsi-border-color = <0xFF>;

		qcom,mdss-dsi-on-command = [
			39 01 00 00 00 00 05 // Page Address Set
			2B 00 00 08 6F

			15 01 00 00 00 00 02 // Memory Access Control
			36 00

			39 01 00 00 00 00 03 // Tear scan line
			44 05 DC

			15 01 00 00 00 00 02 // Manufacturer Command Protection
			B0 AC

			39 01 00 00 00 00 06 // MIPI DSI Configuration
			B1 36 00 80 14 85

			39 01 00 00 00 00 04 // MIPI D-PHY Configuration
			B2 77 04 4C

			39 01 00 00 00 00 09 // Display Control 1
			B3 02 04 0A 00 5C 00 02 12

			39 01 00 00 00 00 12 // Display Control 2
			B4 0A 02 78 05 05 E0 01 00 00 00 00 00 00 00 00 22 96

			39 01 00 00 00 00 13 // Display Control 3
			B5 02 0D 03 01 13 00 00 00 00 00 00 60 05 10 10 10 10 00

			39 01 00 00 00 00 08 // Display Control 4
			B6 00 28 14 5B 04 B6 08

			39 01 00 00 00 00 07 // Panel Setting
			B7 08 50 1B 02 10 8C

			39 01 00 00 00 00 20 // Touch Timing Control
			B8 07 3C 90 44 A6 00 05 00 00 10 04 04 01 40 01 45 1C C2 21 00 00 10 01 01 01 64 00 58 00 00 00

			39 01 00 00 00 00 06 // Touch Source Setting
			B9 32 32 2A 37 03

			39 01 00 00 00 00 07 // Power Control 3
			C3 05 06 06 50 66 1B

			39 01 00 00 00 00 05 // Power Control 4
			C4 A2 AE 90 00

			39 01 00 00 00 00 06 // Power Control 5
			C5 94 44 6C 33 33

			39 01 00 00 00 00 03 // Vcom setting
			C6 12 01

			39 01 00 00 00 00 07 // Power Sequence Option Configuration
			CA 05 1D 80 34 1A FF

			39 01 00 00 00 00 05 // Abrupt Power Off Control
			CB 3F 1B B0 A0

			39 01 00 00 00 00 07 // LFD Control
			CC F3 F0 55 3D 3D 11

			39 01 00 00 00 00 08 // Tail TFT Setting
			CD 05 10 50 90 41 F3 A0

			39 01 00 00 00 00 07 // Touch power control
			CE 48 48 2E 10 00 AB

			39 01 00 00 00 00 7F // Gamma Curve 0
			D0 01 01 15 15 20 20 2A 2A 30
			30 3A 3A 5C 5C 7B 7B 8D 8D 9E
			9E 6D 6D C4 C4 B3 B3 9C 9C 79
			79 53 53 44 44 37 37 21 21 12
			12 00 00 01 01 15 15 20	20 2A
			2A 30 30 3A 3A 5C 5C 7B 7B 8C
			8C 9D 9D 6C 6C C4 C4 B3 B3 9C
			9C 7B 7B 55 55 46 46 3A 3A 24
			24 14 14 00 00 01 01 15 15 20
			20 2A 2A 30 30 3A 3A 5C 5C 7A
			7A 8B 8B 9C 9C 6B 6B C5	C5 B5
			B5 9E 9E 7D 7D 58 58 48 48 3C
			3C 25 25 14 14 00 00

			39 01 00 00 00 00 04 // Sensor setting
			DE 00 44 03

			39 01 00 00 00 00 0D // Left Side GIP Pad Setting
			E5 0E 11 0B 0A 50 06 02 25 0C 25 25 25

			39 01 00 00 00 00 0D // Right Side GIP Pad Setting
			E6 0E 11 0B 0A 50 09 05 25 0C 25 25 25

			39 01 00 00 00 00 0D // Left Side MUX Pad Setting
			E7 58 56 54 57 55 53 18 16 14 17 15 13

			39 01 00 00 00 00 0D // Right Side MUX Pad Setting
			E8 58 56 54 57 55 53 18 16 14 17 15 13

			39 01 00 00 32 00 06 // ESD Auto Recover Setting
			ED 80 00 01 56 08

			15 01 00 00 00 00 02 // Write display brightness
			51 FF

			15 01 00 00 00 00 02 // Write control display
			53 2C

			15 01 00 00 00 00 02 // Image Enhancement
			55 81

			15 01 00 00 00 00 02 // Write cabc min brightness
			5E 00

			39 01 00 00 00 00 18 // CABC ctrl1
			F9 1F 3F 5F 7F
			A0 CF E7 12 1D
			20 20 1B 13 0E
			09 B4 C0 CD DA
			E8 F0 F7 FF

			39 01 00 00 00 00 0F // CABC ctrl2
			FA FF 22 22 22
			20 00 70 22 02
			60 08 70 42 1C

			05 01 00 00 64 00 01 // Sleep out
			11

			15 01 00 00 00 00 02 // TE on
			35 00

			05 01 00 00 0A 00 01 // Display on
			29
		];

		qcom,mdss-dsi-off-command = [
			05 01 00 00 00 00 01 // Display off
			28

			05 01 00 00 8C 00 01 // Sleep in
			10
		];

		lge,mdss-dsi-extra-command-names = "lpwg-on", "cabc-enable", "cabc-disable", "dic-read",
			"enm-toggle-start", "dg-dummy","color-dummy","cabc-30","cabc-50";
		lge,mdss-dsi-extra-command-enm-toggle-start = [
			39 01 00 00 00 00 07 // LFD Control
			CC 73 90 55 3D 3D 11
		];
		lge,mdss-dsi-extra-command-state-enm-toggle-start = "dsi_hs_mode";

		lge,mdss-dsi-extra-command-lpwg-on = [
			39 01 00 00 00 00 05 // Page Address Set
			2B 00 00 08 6F

			15 01 00 00 00 00 02 // Memory Access Control
			36 00

			39 01 00 00 00 00 03 // Tear scan line
			44 05 DC

			15 01 00 00 00 00 02 // Manufacturer Command Protection
			B0 AC

			39 01 00 00 00 00 06 // MIPI DSI Configuration
			B1 36 00 80 14 85

			39 01 00 00 00 00 09 // Display Control 1
			B3 02 04 0A 00 5C 00 02 12

			39 01 00 00 00 00 12 // Display Control 2
			B4 0A 02 78 05 05 E0 01 00 00 00 00 00 00 00 00 22 96

			39 01 00 00 00 00 13 // Display Control 3
			B5 02 0D 03 01 13 00 00 00 00 00 00 60 05 10 10 10 10 00

			39 01 00 00 00 00 08 // Display Control 4
			B6 00 28 14 5B 04 B6 08

			39 01 00 00 00 00 07 // Panel Setting
			B7 08 50 1B 02 10 8C

			39 01 00 00 00 00 20 // Touch Timing Control
			B8 07 3C 90 44 A6 00 05 00 00 10 04 04 01 40 01 45 1C C2 21 00 00 10 01 01 01 64 00 58 00 00 00

			39 01 00 00 00 00 06 // Touch Source Setting
			B9 32 32 2A 37 03

			39 01 00 00 00 00 07 // Power Control 3
			C3 05 06 06 50 66 1B

			39 01 00 00 00 00 05 // Power Control 4
			C4 A2 AE 90 00

			39 01 00 00 00 00 06 // Power Control 5
			C5 94 44 6C 33 33

			39 01 00 00 00 00 03 // Vcom setting
			C6 12 01

			39 01 00 00 00 00 07 // Power Sequence Option Configuration
			CA 05 1D 80 34 1A FF

			39 01 00 00 00 00 05 // Abrupt Power Off Control
			CB 3F 1B B0 A0

			39 01 00 00 00 00 07 // LFD Control
			CC F3 F0 55 3D 3D 11

			39 01 00 00 00 00 08 // Tail TFT Setting
			CD 05 10 50 90 41 F3 A0

			39 01 00 00 00 00 07 // Touch power control
			CE 48 48 2E 10 00 AB

			39 01 00 00 00 00 04 // Sensor setting
			DE 00 44 03

			39 01 00 00 00 00 0D // Left Side GIP Pad Setting
			E5 0E 11 0B 0A 50 06 02 25 0C 25 25 25

			39 01 00 00 00 00 0D // Right Side GIP Pad Setting
			E6 0E 11 0B 0A 50 09 05 25 0C 25 25 25

			39 01 00 00 00 00 0D // Left Side MUX Pad Setting
			E7 58 56 54 57 55 53 18 16 14 17 15 13

			39 01 00 00 00 00 0D // Right Side MUX Pad Setting
			E8 58 56 54 57 55 53 18 16 14 17 15 13

			39 01 00 00 32 00 06 // ESD Auto Recover Setting
			ED 80 00 01 56 08
		];
		lge,mdss-dsi-extra-command-state-lpwg-on = "dsi_lp_mode";

		lge,mdss-dsi-extra-command-cabc-enable = [
			15 01 00 00 00 00 02 // IE Enable
			55 81

			39 01 00 00 00 00 0F
			FA FF 12 22 22
			10 00 70 82 02
			60 08 70 42 1C
		];
		lge,mdss-dsi-extra-command-state-cabc-enable = "dsi_hs_mode";

		lge,mdss-dsi-extra-command-cabc-disable = [
			15 01 00 00 00 00 02 // IE Enable
			55 80

			39 01 00 00 00 00 0F
			FA FF 12 22 22
			10 00 70 80 02
			60 08 70 42 1C
		];
		lge,mdss-dsi-extra-command-state-cabc-disable = "dsi_hs_mode";

		lge,mdss-dsi-extra-command-dg-dummy = [
			39 01 00 00 00 00 11 F4 40 40 40 40 40 40 40 40 00 00 00 00 00 00 00 00 //R
			39 01 00 00 00 00 11 F5 40 40 40 40 40 40 40 40 00 00 00 00 00 00 00 00 //G
			39 01 00 00 00 00 11 F6 40 40 40 40 40 40 40 40 00 00 00 00 00 00 00 00 //B
			39 01 00 00 00 00 02 F0 CA
		];
		lge,mdss-dsi-extra-command-state-dg-dummy = "dsi_hs_mode";

		lge,mdss-dsi-extra-command-color-dummy = [
			39 01 00 00 00 00 05 F2 01 00 1A 00 // Sharpness
			39 01 00 00 00 00 09 F3 00 40 80 C0 00 01 F0 00 // Saturation: 2~6 , Hue: 7~8
			39 01 00 00 00 00 02 F0 CA
		];
		lge,mdss-dsi-extra-command-state-color-dummy = "dsi_hs_mode";

		lge,mdss-dsi-extra-command-cabc-30 = [
			39 01 00 00 00 00 18 F9 1F 3F 5F 7F A0 CF E7 12 1D 20 20 1B 13 0E 09 B4 C0 CD DA E8 F0 F7 FF
		];
		lge,mdss-dsi-extra-command-state-cabc-30 = "dsi_hs_mode";

		lge,mdss-dsi-extra-command-cabc-50 = [
			39 01 00 00 00 00 18 F9 1F 3F 5F 7F A0 CF E7 12 1D 20 20 1B 13 0E 09 7F 91 A3 B6 C8 DA EC FF
		];
		lge,mdss-dsi-extra-command-state-cabc-50 = "dsi_hs_mode";

		lge,mdss-dsi-extra-command-dic-read = [
			// Display block power state
			06 01 00 00 05 00 02
			0A 00
			// Display control for SRC output timing / GIP ctrl / mux ctrl / display clk
			06 01 00 00 05 00 09 // Display Control 1
			B3 02 04 0A 00 5C 00 02 12
			06 01 00 00 05 00 12 // Display Control 2
			B4 0A 02 78 05 05 E0 01 00 00 00 00 00 00 00 00 22 96
			06 01 00 00 05 00 13 // Display Control 3
			B5 02 0D 03 01 13 00 00 00 00 00 00 60 05 10 10 10 10 00
			06 01 00 00 05 00 08 // Display Control 4
			B6 00 2A 14 08 04 10 08
			// Touch timing ctrl
			06 01 00 00 05 00 20 // Touch Timing Control
			B8 07 3C 68 41 50 00 05 00 00 30 04 04 01 40 01 45 1C C2 21 00 00 10 01 01 01 64 E0 5A 00 00 00
		];
		lge,mdss-dsi-extra-command-state-dic-read = "dsi_hs_mode";

		qcom,mdss-dsi-on-command-state = "dsi_lp_mode";
		qcom,mdss-dsi-off-command-state = "dsi_hs_mode";
		qcom,mdss-dsi-h-sync-pulse = <1>;
		qcom,mdss-dsi-traffic-mode = "non_burst_sync_pulse";
		qcom,mdss-dsi-lane-map = "lane_map_0123";
		qcom,mdss-dsi-dma-trigger = "trigger_sw";
		qcom,mdss-dsi-mdp-trigger = "none";
		qcom,mdss-dsi-bllp-eof-power-mode;
		qcom,mdss-dsi-bllp-power-mode;
		qcom,ulps-enabled;
		qcom,suspend-ulps-enabled;
		qcom,mdss-dsi-lane-0-state;
		qcom,mdss-dsi-lane-1-state;
		qcom,mdss-dsi-lane-2-state;
		qcom,mdss-dsi-lane-3-state;
		qcom,mdss-dsi-tx-eot-append;

		qcom,mdss-dsi-panel-timings-phy-v2 = [
			25 1F 09 0A 06 03 04 a0
			25 1F 09 0A 06 03 04 a0
			25 1F 09 0A 06 03 04 a0
			25 1F 09 0A 06 03 04 a0
			25 1E 08 0A 06 03 04 a0
		];
		qcom,mdss-dsi-t-clk-post = <0x0E>;
		qcom,mdss-dsi-t-clk-pre = <0x34>;

		qcom,mdss-dsi-bl-min-level = <1>;
		qcom,mdss-dsi-bl-max-level = <255>;
		qcom,mdss-dsi-bl-pmic-control-type = "bl_ctrl_wled";
		qcom,mdss-dsi-reset-sequence = <0 1>, <1 1>;

		lge,mdss-dsi-lp11-off;
		lge,panel-type = "TOVIS-SW49107";
		lge,panel-id = <1>;

		qcom,mdss-dsi-te-pin-select = <1>;
		qcom,mdss-dsi-te-dcs-command = <1>;
		qcom,mdss-dsi-te-check-enable;
		qcom,mdss-dsi-te-using-te-pin;
		qcom,mdss-dsi-wr-mem-start = <0x2c>;
		qcom,mdss-dsi-wr-mem-continue = <0x3c>;

		lge,blmap-size = <256>;
		lge,blmap = <	//LED revision 1
			0	9	9	9	9	9	9	9	9	9		/* 0 ~ 9 */
			9	9	9	9	9	9	9	12	12	12		/* 10 ~ 19 */
			12	12	12	13	13	14	15	16	16	17		/* 20 ~ 29 */
			18	19	19	20	21	22	23	24	25	27		/* 30 ~ 39 */
			28	29	31	32	33	34	36	37	38	40		/* 40 ~ 49 */
			42	44	47	49	52	54	56	59	61	64		/* 50 ~ 59 */
			66	68	70	72	75	77	79	81	83	86		/* 60 ~ 69 */
			88	90	92	95	98	102	105	109	112	116		/* 70 ~ 79 */
			120	123	127	130	134	138	142	146	150	154		/* 80 ~ 89 */
			158	162	166	170	174	178	182	186	190	196		/* 90 ~ 99 */
			202	209	215	221	228	234	240	247	253	260		/* 100 ~ 109 */
			263	267	271	275	279	283	286	290	294	298		/* 110 ~ 119 */
			302	306	310	318	327	336	344	353	362	370		/* 120 ~ 129 */
			379	388	396	405	414	422	431	440	448	457		/* 130 ~ 139 */
			466	475	483	492	501	510	520	530	550	570		/* 140 ~ 149 */
			575	580	585	590	595	600	605	610	615	625		/* 150 ~ 159 */
			640	650	670	685	700	715	730	745	760	775		/* 160 ~ 169 */
			790	800	810	820	830	840	850	860	870	880		/* 170 ~ 179 */
			890	900	910	920	930	940	950	960	970	980		/* 180 ~ 189 */
			990	1000	1010	1020	1030	1040	1050	1060	1070	1080		/* 190 ~ 199 */
			1090	1100	1112	1126	1141	1156	1170	1185	1200	1214		/* 200 ~ 209 */
			1229	1243	1258	1272	1287	1301	1316	1330	1345	1360		/* 210 ~ 219 */
			1376	1393	1410	1427	1444	1461	1478	1495	1512	1529		/* 220 ~ 229 */
			1546	1563	1580	1595	1611	1627	1643	1659	1675	1690		/* 230 ~ 239 */
			1706	1722	1738	1754	1770	1792	1815	1838	1860	1883		/* 240 ~ 249 */
			1906	1929	1951	1974	1997	2021						/* 250 ~ 255 */
		>;
	};
};
