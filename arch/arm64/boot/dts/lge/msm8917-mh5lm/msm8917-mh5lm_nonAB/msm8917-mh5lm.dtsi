/*
 * Copyright (c) 2015-2018, The Linux Foundation. All rights reserved.
 *
 * This program is free software; you can redistribute it and/or modify
 * it under the terms of the GNU General Public License version 2 and
 * only version 2 as published by the Free Software Foundation.
 *
 * This program is distributed in the hope that it will be useful,
 * but WITHOUT ANY WARRANTY; without even the implied warranty of
 * MERCHANTABILITY or FITNESS FOR A PARTICULAR PURPOSE.  See the
 * GNU General Public License for more details.
 */

#include <dt-bindings/gpio/gpio.h>
#include <dt-bindings/interrupt-controller/arm-gic.h>
#include <dt-bindings/clock/msm-clocks-8952.h>

#include "../msm8917-mh5lm_common/msm8917-mh5lm_common.dtsi"
#include "../msm8917-mh5lm/msm8917-mh5lm-camera.dtsi"
#include "../msm8917-mh5lm/msm8917-mh5lm-connectivity.dtsi"
#include "../msm8917-mh5lm/msm8917-mh5lm-fingerprint.dtsi"
#include "../msm8917-mh5lm/msm8917-mh5lm-sensor.dtsi"
#include "../msm8917-mh5lm/msm8917-mh5lm-misc.dtsi"
#include "../msm8917-mh5lm/msm8917-mh5lm-nfc.dtsi"
#include "../msm8917-mh5lm/msm8917-mh5lm-panel.dtsi"
#include "../msm8917-mh5lm/msm8917-mh5lm-pinctrl.dtsi"
#include "../msm8917-mh5lm/msm8917-mh5lm-pm.dtsi"
#include "../msm8917-mh5lm/msm8917-mh5lm-sound.dtsi"
#include "../msm8917-mh5lm/msm8917-mh5lm-storage.dtsi"
#include "../msm8917-mh5lm/msm8917-mh5lm-tdmb.dtsi"
#include "../msm8917-mh5lm/msm8917-mh5lm-touch.dtsi"
#include "../msm8917-mh5lm/msm8917-mh5lm-usb.dtsi"
#include "../../tps61280.dtsi"
