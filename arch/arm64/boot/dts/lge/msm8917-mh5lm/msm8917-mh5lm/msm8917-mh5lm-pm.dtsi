/*
 * Copyright (c) 2015-2018, The Linux Foundation. All rights reserved.
 *
 * This program is free software; you can redistribute it and/or modify
 * it under the terms of the GNU General Public License version 2 and
 * only version 2 as published by the Free Software Foundation.
 *
 * This program is distributed in the hope that it will be useful,
 * but WITHOUT ANY WARRANTY; without even the implied warranty of
 * MERCHANTABILITY or FITNESS FOR A PARTICULAR PURPOSE.  See the
 * GNU General Public License for more details.
 */

#include "../msm8917-mh5lm_common/msm8917-mh5lm_common-pm.dtsi"

&qpnp_fg {
    qcom,fg-cutoff-voltage-mv = <3400>;
};

&qpnp_smbcharger {
    qcom,fastchg-current-ma = <1800>;
};

&pmi_haptic{
    status = "okay";
    qcom,actuator-type = <1>;
    qcom,vmax-mv = <3016>;
    qcom,brake-pattern = <0x0 0x0 0x0 0x0>;
};

