/* Copyright (c) 2014, Code Aurora Forum. All rights reserved.
 *
 * This program is free software; you can redistribute it and/or modify
 * it under the terms of the GNU General Public License version 2 and
 * only version 2 as published by the Free Software Foundation.
 *
 * This program is distributed in the hope that it will be useful,
 * but WITHOUT ANY WARRANTY; without even the implied warranty of
 * MERCHANTABILITY or FITNESS FOR A PARTICULAR PURPOSE.  See the
 * GNU General Public License for more details.
 */

&mdss_mdp {
	dsi_tovis_td4310_px8418_vid: qcom,mdss_dsi_tovis_td4310_px8418_video {
		compatible = "qcom,mdss-dsi-panel";
		status = "ok";
		qcom,cont-splash-enabled;
		qcom,mdss-dsi-panel-name = "TOVIS TD4310 PX8418 video mode dsi panel";
		qcom,mdss-dsi-panel-controller = <&mdss_dsi0>;
		qcom,mdss-dsi-panel-type = "dsi_video_mode";
		qcom,mdss-dsi-panel-destination = "display_1";
		qcom,mdss-dsi-panel-framerate = <60>;
		qcom,mdss-dsi-panel-clockrate = <960000000>;
		qcom,mdss-dsi-virtual-channel-id = <0>;
		qcom,mdss-dsi-stream = <0>;
		qcom,mdss-dsi-lp11-init;
		qcom,mdss-dsi-panel-width = <1080>;
		qcom,mdss-dsi-panel-height = <2160>;
		qcom,mdss-dsi-h-front-porch = <100>;
		qcom,mdss-dsi-h-back-porch = <28>;
		qcom,mdss-dsi-h-pulse-width = <4>;
		qcom,mdss-dsi-h-sync-skew = <0>;
		qcom,mdss-dsi-v-front-porch = <10>;
		qcom,mdss-dsi-v-back-porch = <28>;
		qcom,mdss-dsi-v-pulse-width = <2>;
		qcom,mdss-dsi-h-left-border = <0>;
		qcom,mdss-dsi-h-right-border = <0>;
		qcom,mdss-dsi-v-top-border = <0>;
		qcom,mdss-dsi-v-bottom-border = <0>;

		qcom,mdss-pan-physical-width-dimension = <70>;
		qcom,mdss-pan-physical-height-dimension = <140>;

		qcom,mdss-dsi-bpp = <24>;
		qcom,mdss-dsi-color-order = "rgb_swap_rgb";
		qcom,mdss-dsi-underflow-color = <0xFF>;
		qcom,mdss-dsi-border-color = <0xFF>;

		qcom,mdss-dsi-on-command = [
			// MCAP: Manufacturer Command Access Protect
			29 01 00 00 00 00 02
			B0 00
			// Interface Setting
			29 01 00 00 00 00 04
			B3 31 00 06
			// Interface ID Setting
			29 01 00 00 00 00 02
			B4 00
			// DSI Control +
			29 01 00 00 00 00 06
			B6 33 5B 81 12 00
			// Backlight Control 1 (C = 1 GUI)
			29 01 00 00 00 00 08
			B8 57 3D 19 1E 0A 50 50
			// Backlight Control 2 (C = 2 still)
			29 01 00 00 00 00 08
			B9 6F 3D 28 3C 14 C8 C8
			// Backlight Control 3 (C = 3 movie)
			29 01 00 00 00 00 08
			BA B5 33 41 64 23 A0 A0
			// Sunlight Readability Enhancement (SRE control 1, SRE = 1 weak setting)
			29 01 00 00 00 00 03
			BB 14 14
			// Sunlight Readability Enhancement (SRE control 2, SRE = 2 middle setting)
			29 01 00 00 00 00 03
			BC 37 32
			// Sunlight Readability Enhancement (SRE control 3, SRE = 3 strong setting)
			29 01 00 00 00 00 03
			BD 64 02
			// External Clock Setting
			29 01 00 00 00 00 02
			BE 04
			// Skew Rate Adjustment
			29 01 00 00 00 00 02
			C0 00
			// Display Setting1 Common
			29 01 00 00 00 00 31
			C1 04 40 00 FF FF FF FF FF FF FF FF FF FF FF FF
			FF FF FF FF FF FF FF FF FF FF 0F 00 00 00 00 00
			00 00 00 40 02 22 02 06 0A 00 00 01 00 01 00 00
			00
			// Display Setting2
			29 01 00 00 00 00 19
			C2 01 F8 70 0A 6A 0A 0C 10 00 08 30 00 00 00 00
			00 00 00 00 0E 00 00 00 00
			// Display Setting3
			29 01 00 00 00 00 3F
			C3 86 D8 6D 86 D0 00 00 00 00 00 40 B4 0B 00 00
			45 14 51 00 00 01 01 03 28 00 01 00 01 00 00 13
			00 13 00 2C 01 00 00 00 00 00 00 00 00 00 00 00
			00 24 00 24 00 5A 02 00 00 00 00 00 00 40 00
			// Source Timing Setting and SOUT Equalize Setting
			29 01 00 00 00 00 15
			C4 70 00 00 00 00 00 00 00 00 02 02 31 01 00 00
			00 02 01 01 01
			// Crosshair
			29 01 00 00 00 00 09
			C5 08 00 00 00 00 70 00 00
			// LTPS Timing Setting
			29 01 00 00 00 00 40
			C6 45 01 44 02 3D 01 0E 01 02 01 02 01 02 00 00
			00 00 04 10 04 45 00 47 53 00 00 00 00 00 00 00
			00 00 00 00 00 00 00 00 00 00 00 00 00 00 00 00
			00 00 00 00 00 00 00 00 00 00 00 00 00 00 00 00
			// Gamma Setting Common Set
			29 01 00 00 00 00 27
			C7 00 1A 28 38 46 50 65 73 7E 88 39 43 50 64 6F
			7C 8E 99 A2 00 1A 28 38 06 50 65 73 7E 88 39 43
			50 64 6F 7C 8E 99 A2
			// Digital Gamma Setting 1
			29 01 00 00 00 00 38
			C8 00 00 00 00 00 FC 00 00 00 00 00 FC 00 00 00
			00 00 FC 00 00 00 00 00 FC 00 00 00 00 00 FC 00
			00 00 00 00 FC 00 00 00 00 00 FC 00 00 00 00 00
			FC 00 00 00 00 00 FC 00
			// Digital Gamma Setting 2
			29 01 00 00 00 00 14
			C9 00 00 00 00 00 FC 00 00 00 00 00 FC 00 00 00
			00 00 FC 00
			// Color Enhancement
			29 01 00 00 00 00 2C
			CA 1C FC FC FC 00 00 00 00 00 00 00 00 00 00 00
			00 00 00 00 00 00 00 00 00 00 00 00 00 00 00 00
			00 00 00 00 00 00 00 00 00 00 00 00
			// Panel PIN Control
			29 01 00 00 00 00 1C
			CB FF FF FF FF 0F 80 00 00 10 00 11 F0 00 0D 00
			00 00 00 00 00 00 00 00 00 00 00 00
			// Panel Interface Control
			29 01 00 00 00 00 03
			CC 22 00
			// Touch Control
			29 01 00 00 00 00 27
			CD 1F 00 21 00 21 00 5C 02 C1 C1 DE DE B1 B1 DD
			DD 01 00 00 00 00 00 00 00 00 00 00 00 00 00 00
			00 00 00 00 00 00 A2
			// Backlight Control 4
			29 01 00 00 00 00 1A
			CE 5D 40 49 53 59 5E 63 68 6E 74 7E 8A 98 A8 BB
			D0 FF 04 00 04 04 42 00 69 5A
			// Panel Synchronous Output
			29 01 00 00 00 00 03
			CF 48 1D
			// Power Setting for CHGP
			29 01 00 00 00 00 14
			D0 33 54 D4 31 01 10 10 10 19 19 00 00 00 00 00
			00 00 6D 65
			// Touch Period and Source Drive Mode Select
			29 01 00 00 00 00 02
			D1 00
			// Power Setting for Internal Power
			29 01 00 00 00 00 16
			D3 1B 3B BB 77 77 77 BB B3 33 00 00 6C 69 C7 C7
			33 BB F2 FD C6 0B
			// VCOM Setting
			29 01 00 00 00 00 0B
			D5 00 00 00 02 40 02 40 01 00 00
			// Timing Control for Power on Sequencer Test Mode
			29 01 00 00 00 00 22
			D7 86 FF 03 05 41 24 80 1F C7 1F 1B 00 0C 07 20
			00 00 00 00 00 0C F0 1F 00 0C 00 00 AA 67 7E 1D
			06 00
			// Power Sequencer Control
			29 01 00 00 00 00 08
			D9 00 02 14 3D 00 77 02
			// Outline Sharpening Control
			29 01 00 00 00 00 05
			DD 30 06 23 65
			// Test Image Generator
			29 01 00 00 00 00 05
			DE 00 3F FF 90
			// ESD Detect Setting
			29 01 00 00 00 00 02
			EA 9F
			// Glass Break Detect Setting
			29 01 00 00 00 00 04
			EE 41 51 00
			// Test Register
			29 01 00 00 00 00 04
			F1 00 00 00
			// Sequencer Test Control
			29 01 00 00 00 00 02
			D6 41
			// write_display_brightness
			39 01 00 00 00 00 02
			51 FF
			// write_control_display
			39 01 00 00 00 00 02
			53 0C
			// write_content_adaptive_brightness_control
			39 01 00 00 00 00 02
			55 00
			// Sleep out
			05 01 00 00 78 00 01
			11
			// Display on APO noraml
			29 01 00 00 00 00 02
			B0 00
			29 01 00 00 00 00 31
			C1 04 40 00 FF 5F 6B 89 B0 6A 85 0F A3 FC FF FF
			FF 65 84 1F 2C 65 CB B0 F6 FE 0F 00 00 00 00 00
			00 00 00 40 02 22 02 06 0A 00 00 01 00 05 00 00
			00
			29 01 00 00 00 00 1C
			CB FF FF FF FF 0F 00 00 00 00 00 11 F0 00 0D 00
			00 00 00 00 00 00 00 00 00 00 00 00
			// Display on
			05 01 00 00 78 00 01
			29
		];

		qcom,mdss-dsi-off-command = [
			// Display off
			05 01 00 00 78 00 01
			28
			// Display off APO code
			29 01 00 00 00 00 02
			B0 00
			29 01 00 00 00 00 31
			C1 04 40 00 FF FF FF FF FF EA FF FF FF FF FF FF
			FF FF FF FF 7F F5 FF FF FF FF 0F 00 00 00 00 00
			00 00 00 40 02 22 02 06 0A 00 00 01 00 01 00 00
			00
			29 01 00 00 00 00 1C
			CB FF FF FF FF 0F FC 76 E0 F6 03 11 F0 00 0D 00
			00 00 00 00 00 00 00 00 00 00 00 00
			// Sleep in
			05 01 00 00 78 00 01
			10
		];

		qcom,mdss-dsi-on-command-state = "dsi_lp_mode";
		qcom,mdss-dsi-off-command-state = "dsi_hs_mode";
		qcom,mdss-dsi-h-sync-pulse = <0>;
		qcom,mdss-dsi-traffic-mode = "burst_mode";
		qcom,mdss-dsi-lane-map = "lane_map_0123";
		qcom,mdss-dsi-dma-trigger = "trigger_sw";
		qcom,mdss-dsi-mdp-trigger = "none";
		qcom,mdss-dsi-bllp-eof-power-mode;
		qcom,mdss-dsi-bllp-power-mode;
		//qcom,ulps-enabled;
		//qcom,suspend-ulps-enabled;
		qcom,mdss-dsi-lane-0-state;
		qcom,mdss-dsi-lane-1-state;
		qcom,mdss-dsi-lane-2-state;
		qcom,mdss-dsi-lane-3-state;
		qcom,mdss-dsi-tx-eot-append;

		qcom,mdss-dsi-panel-timings-phy-v2 = [
			24 20 08 0A 05 03 04 a0
			24 20 08 0A 05 03 04 a0
			24 20 08 0A 05 03 04 a0
			24 20 08 0A 05 03 04 a0
			24 1D 08 0A 05 03 04 a0
		];
		qcom,mdss-dsi-t-clk-post = <0x0E>;
		qcom,mdss-dsi-t-clk-pre = <0x32>;

		qcom,mdss-dsi-bl-min-level = <1>;
		qcom,mdss-dsi-bl-max-level = <255>;
		qcom,mdss-dsi-reset-sequence = <0 1>, <1 1>;

		lge,blmap-size = <256>;
		lge,blmap = <
			0	6	6	6	6	6	6	6	6	6		/* 0 ~ 9 */
			6	6	6	6	7	7	7	8	8	8		/* 10 ~ 19 */
			9	9	9	10	11	12	13	14	15	16		/* 20 ~ 29 */
			17	18	19	20	21	22	23	24	25	27		/* 30 ~ 39 */
			28	29	31	32	33	34	36	37	38	40		/* 40 ~ 49 */
			40	41	42	42	43	44	44	45	46	47		/* 50 ~ 59 */
			49	51	53	55	58	60	62	64	66	69		/* 60 ~ 69 */
			71	73	75	78	80	83	86	89	92	95		/* 70 ~ 79 */
			97	100	103	106	109	112	115	119	122	126		/* 80 ~ 89 */
			129	133	136	140	143	147	150	154	158	160		/* 90 ~ 99 */
			163	165	168	171	173	176	179	181	184	187		/* 100 ~ 109 */
			191	196	200	205	210	214	219	223	228	233		/* 110 ~ 119 */
			237	242	247	252	257	263	268	274	279	284		/* 120 ~ 129 */
			290	295	301	306	312	318	324	330	336	342		/* 130 ~ 139 */
			348	354	360	366	372	379	385	391	397	403		/* 140 ~ 149 */
			410	416	422	428	435	441	447	453	460	467		/* 150 ~ 159 */
			474	481	488	495	502	509	516	523	530	537		/* 160 ~ 169 */
			544	552	561	569	578	586	595	603	612	620		/* 170 ~ 179 */
			629	637	646	655	664	673	683	692	702	711		/* 180 ~ 189 */
			720	730	739	749	758	768	777	786	796	805		/* 190 ~ 199 */
			814	824	833	843	852	861	871	880	890	901		/* 200 ~ 209 */
			912	924	935	947	958	970	981	993	1004	1016		/* 210 ~ 219 */
			1028	1040	1053	1065	1078	1090	1103	1115	1128	1140		/* 220 ~ 229 */
			1153	1165	1178	1191	1205	1218	1232	1245	1259	1272		/* 230 ~ 239 */
			1286	1299	1313	1326	1340	1354	1369	1383	1398	1412		/* 240 ~ 249 */
			1427	1441	1456	1470	1485	1500						/* 250 ~ 255 */
		>;
		lge,panel-type = "TOVIS-TD4310";
	};
};
