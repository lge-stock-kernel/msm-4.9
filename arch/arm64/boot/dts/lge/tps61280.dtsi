/*
 * Copyright (c) 2016, The Linux Foundation. All rights reserved.
 *
 * This program is free software; you can redistribute it and/or modify
 * it under the terms of the GNU General Public License version 2 and
 * only version 2 as published by the Free Software Foundation.
 *
 * This program is distributed in the hope that it will be useful,
 * but WITHOUT ANY WARRANTY; without even the implied warranty of
 * MERCHANTABILITY or FITNESS FOR A PARTICULAR PURPOSE.  See the
 * GNU General Public License for more details.
 */

&i2c_2 {
	tps61280@75 {
		status = "okay";
		compatible = "ti,tps61280";
		reg = <0x75>;
		tps61280,chip_enable = <&tlmm 96 0x00>;
    
		pinctrl-0 = <&tps61280_chip_enable_active>;
		pinctrl-1 = <&tps61280_chip_enable_sleep>;
	};
};
