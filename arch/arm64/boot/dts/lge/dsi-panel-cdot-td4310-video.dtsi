/* Copyright (c) 2014, Code Aurora Forum. All rights reserved.
 *
 * This program is free software; you can redistribute it and/or modify
 * it under the terms of the GNU General Public License version 2 and
 * only version 2 as published by the Free Software Foundation.
 *
 * This program is distributed in the hope that it will be useful,
 * but WITHOUT ANY WARRANTY; without even the implied warranty of
 * MERCHANTABILITY or FITNESS FOR A PARTICULAR PURPOSE.  See the
 * GNU General Public License for more details.
 */

&mdss_mdp {
	dsi_cdot_td4310_vid: qcom,mdss_dsi_cdot_td4310_video {
		compatible = "qcom,mdss-dsi-panel";
		status = "ok";
		qcom,cont-splash-enabled;
		qcom,mdss-dsi-panel-name = "CDOT TD4310 video mode dsi panel";
		qcom,mdss-dsi-panel-controller = <&mdss_dsi0>;
		qcom,mdss-dsi-panel-type = "dsi_video_mode";
		qcom,mdss-dsi-panel-destination = "display_1";
		qcom,mdss-dsi-panel-framerate = <60>;
		qcom,mdss-dsi-virtual-channel-id = <0>;
		qcom,mdss-dsi-stream = <0>;
		qcom,mdss-dsi-lp11-init;
		qcom,mdss-dsi-panel-width = <1080>;
		qcom,mdss-dsi-panel-height = <2160>;
		qcom,mdss-dsi-h-front-porch = <100>;
		qcom,mdss-dsi-h-back-porch = <30>;
		qcom,mdss-dsi-h-pulse-width = <2>;
		qcom,mdss-dsi-h-sync-skew = <0>;
		qcom,mdss-dsi-v-front-porch = <8>;
		qcom,mdss-dsi-v-back-porch = <33>;
		qcom,mdss-dsi-v-pulse-width = <2>;
		qcom,mdss-dsi-h-left-border = <0>;
		qcom,mdss-dsi-h-right-border = <0>;
		qcom,mdss-dsi-v-top-border = <0>;
		qcom,mdss-dsi-v-bottom-border = <0>;

		qcom,mdss-pan-physical-width-dimension = <70>;
		qcom,mdss-pan-physical-height-dimension = <140>;

		qcom,mdss-dsi-bpp = <24>;
		qcom,mdss-dsi-color-order = "rgb_swap_rgb";
		qcom,mdss-dsi-underflow-color = <0xFF>;
		qcom,mdss-dsi-border-color = <0xFF>;

		qcom,mdss-dsi-on-command = [
			// write_display_brightness
			39 01 00 00 00 00 02
			51 FF
			// write_control_display
			39 01 00 00 00 00 02
			53 0C
			// write_content_adaptive_brightness_control
			39 01 00 00 00 00 02
			55 00

			05 01 00 00 64 00 01 // Sleep out
			11

			05 01 00 00 05 00 01 // Display on
			29
		];

		qcom,mdss-dsi-off-command = [
			05 01 00 00 00 00 01 // Display off
			28

			05 01 00 00 8C 00 01 // Sleep in
			10
		];

		qcom,mdss-dsi-on-command-state = "dsi_lp_mode";
		qcom,mdss-dsi-off-command-state = "dsi_hs_mode";
		qcom,mdss-dsi-h-sync-pulse = <0>;
		qcom,mdss-dsi-traffic-mode = "non_burst_sync_event";
		qcom,mdss-dsi-lane-map = "lane_map_0123";
		qcom,mdss-dsi-dma-trigger = "trigger_sw";
		qcom,mdss-dsi-mdp-trigger = "none";
		qcom,mdss-dsi-bllp-eof-power-mode;
		qcom,mdss-dsi-bllp-power-mode;
		//qcom,ulps-enabled;
		//qcom,suspend-ulps-enabled;
		qcom,mdss-dsi-lane-0-state;
		qcom,mdss-dsi-lane-1-state;
		qcom,mdss-dsi-lane-2-state;
		qcom,mdss-dsi-lane-3-state;
		qcom,mdss-dsi-tx-eot-append;

		qcom,mdss-dsi-panel-timings-phy-v2 = [
			25 20 08 0A 06 02 04 A0
			25 20 08 0A 06 02 04 A0
			25 20 08 0A 06 02 04 A0
			25 20 08 0A 06 02 04 A0
			25 1D 08 0A 06 02 04 A0
		];
		qcom,mdss-dsi-t-clk-post = <0x0E>;
		qcom,mdss-dsi-t-clk-pre = <0x33>;

		qcom,mdss-dsi-bl-min-level = <1>;
		qcom,mdss-dsi-bl-max-level = <255>;
		qcom,mdss-dsi-reset-sequence = <0 1>, <1 1>;

		lge,blmap-size = <256>;
		lge,blmap = <
			0	11	11	11	11	11	11	11	11	11		/* 0 ~ 9 */
			11	11	11	11	11	11	11	12	12	12		/* 10 ~ 19 */
			12	12	12	13	13	14	15	16	16	17		/* 20 ~ 29 */
			18	19	19	20	21	22	23	24	25	27		/* 30 ~ 39 */
			28	29	31	32	33	34	36	37	38	40		/* 40 ~ 49 */
			42	44	47	49	52	54	56	59	61	64		/* 50 ~ 59 */
			66	68	70	72	75	77	79	81	83	86		/* 60 ~ 69 */
			88	90	92	95	98	102	105	109	112	116		/* 70 ~ 79 */
			120	123	127	130	134	138	142	146	150	154		/* 80 ~ 89 */
			158	162	166	170	174	178	182	186	190	196		/* 90 ~ 99 */
			202	209	215	221	228	234	240	247	253	260		/* 100 ~ 109 */
			263	267	271	275	279	283	286	290	294	298		/* 110 ~ 119 */
			302	306	310	318	327	336	344	353	362	370		/* 120 ~ 129 */
			379	388	396	405	414	422	431	440	448	457		/* 130 ~ 139 */
			466	475	483	492	501	510	520	530	550	570		/* 140 ~ 149 */
			575	580	585	590	595	600	605	610	615	625		/* 150 ~ 159 */
			640	650	670	685	700	715	730	745	760	775		/* 160 ~ 169 */
			790	800	810	820	830	840	850	860	870	880		/* 170 ~ 179 */
			890	900	910	920	930	940	950	960	970	980		/* 180 ~ 189 */
			990	1000	1010	1020	1030	1040	1050	1060	1070	1080		/* 190 ~ 199 */
			1090	1100	1112	1126	1141	1156	1170	1185	1200	1214		/* 200 ~ 209 */
			1229	1243	1258	1272	1287	1301	1316	1330	1345	1360		/* 210 ~ 219 */
			1376	1393	1410	1427	1444	1461	1478	1495	1512	1529		/* 220 ~ 229 */
			1546	1563	1580	1595	1611	1627	1643	1659	1675	1690		/* 230 ~ 239 */
			1706	1722	1738	1754	1770	1792	1815	1838	1860	1883		/* 240 ~ 249 */
			1906	1929	1951	1974	1997	2020						/* 250 ~ 255 */
		>;
		lge,panel-type = "CDOT-TD4310";
		lge,ddic = "synaptics,td4310";
	};
};
