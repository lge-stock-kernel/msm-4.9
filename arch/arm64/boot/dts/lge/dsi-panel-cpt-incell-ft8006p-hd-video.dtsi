/* Copyright (c) 2013-2015, The Linux Foundation. All rights reserved.
 *
 * This program is free software; you can redistribute it and/or modify
 * it under the terms of the GNU General Public License version 2 and
 * only version 2 as published by the Free Software Foundation.
 *
 * This program is distributed in the hope that it will be useful,
 * but WITHOUT ANY WARRANTY; without even the implied warranty of
 * MERCHANTABILITY or FITNESS FOR A PARTICULAR PURPOSE.  See the
 * GNU General Public License for more details.
 */

&mdss_mdp {
	dsi_cpt_incell_ft8006p_hd_vid: qcom,mdss_dsi_cpt_ft8006p_hd_video {
		compatible = "qcom,mdss-dsi-panel";
		status = "ok";
		qcom,cont-splash-enabled;
		qcom,mdss-dsi-panel-name = "CPT INCELL FT8006P HD video mode dsi panel";
		qcom,mdss-dsi-panel-controller = <&mdss_dsi0>;
		qcom,mdss-dsi-panel-type = "dsi_video_mode";
		qcom,mdss-dsi-panel-destination = "display_1";
		qcom,mdss-dsi-virtual-channel-id = <0>;
		qcom,mdss-dsi-stream = <0>;
		qcom,mdss-dsi-panel-framerate = <60>;
		qcom,mdss-dsi-bpp = <24>;
		qcom,mdss-dsi-panel-width = <720>;
		qcom,mdss-dsi-panel-height = <1440>;
		qcom,mdss-dsi-h-front-porch = <45>;
		qcom,mdss-dsi-h-back-porch = <25>;
		qcom,mdss-dsi-h-pulse-width = <14>;
		qcom,mdss-dsi-h-sync-skew = <0>;
		qcom,mdss-dsi-v-front-porch = <140>;
		qcom,mdss-dsi-v-back-porch = <106>;
		qcom,mdss-dsi-v-pulse-width = <8>;

		qcom,mdss-dsi-h-left-border = <0>;
		qcom,mdss-dsi-h-right-border = <0>;
		qcom,mdss-dsi-v-top-border = <0>;
		qcom,mdss-dsi-v-bottom-border = <0>;

		qcom,mdss-dsi-underflow-color = <0xff>;
		qcom,mdss-dsi-border-color = <0>;

		qcom,mdss-pan-physical-width-dimension = <64>;
		qcom,mdss-pan-physical-height-dimension = <129>;

		qcom,mdss-dsi-on-command = [
			/* Sleep Out */
			05 01 00 00 78 00 01 11
			/* Display On */
			05 01 00 00 96 00 01 29
		];
		qcom,mdss-dsi-off-command = [
			05 01 00 00 14 00 01 28
			05 01 00 00 78 00 01 10
		];

/*
		lge,mdss-dsi-extra-command-names = "lpwg-on";

		lge,mdss-dsi-extra-command-lpwg-on = [
		];

		lge,mdss-dsi-extra-command-state-lpwg-on = "dsi_lp_mode";
*/
		qcom,mdss-dsi-on-command-state = "dsi_lp_mode";
		qcom,mdss-dsi-off-command-state = "dsi_lp_mode";

		qcom,mdss-dsi-reset-sequence = <0 5>, <2 50>;
		qcom,mdss-dsi-lp11-init;
		qcom,mdss-dsi-h-sync-pulse = <1>;
		qcom,mdss-dsi-traffic-mode = "non_burst_sync_pulse";
		qcom,mdss-dsi-lane-map = "lane_map_0123";
		qcom,mdss-dsi-dma-trigger = "trigger_sw";
		qcom,mdss-dsi-mdp-trigger = "none";
		qcom,mdss-dsi-color-order = "rgb_swap_rgb";
		qcom,mdss-dsi-bllp-eof-power-mode;
		qcom,mdss-dsi-bllp-power-mode;
		qcom,mdss-dsi-tx-eot-append;
		qcom,suspend-ulps-enabled;
		qcom,mdss-dsi-lane-0-state;
		qcom,mdss-dsi-lane-1-state;
		qcom,mdss-dsi-lane-2-state;
		qcom,mdss-dsi-lane-3-state;

		qcom,mdss-dsi-panel-timings-phy-v2 = [
			1F 1C 04 06 03 03 04 a0
			1F 1C 04 06 03 03 04 a0
			1F 1C 04 06 03 03 04 a0
			1F 1C 04 06 03 03 04 a0
			1F 0F 04 06 03 03 04 a0
		];
		qcom,mdss-dsi-t-clk-post = <0x10>;
		qcom,mdss-dsi-t-clk-pre = <0x32>;

		qcom,mdss-dsi-bl-min-level = <1>;
		qcom,mdss-dsi-bl-max-level = <255>;

		lge,blmap-size = <256>;
		lge,blmap = <
			0 16 32 48 64 80 96 112 128 145 /* 0 ~ 9 */
			161 177 193 209 225 241 257 273 289 305 /* 10 ~ 19 */
			321 337 353 369 385 401 418 434 450 466 /* 20 ~ 29 */
			482 498 514 530 546 562 578 594 610 626 /* 30 ~ 39 */
			642 658 674 691 707 723 739 755 771 787 /* 40 ~ 49 */
			803 819 835 851 867 883 899 915 931 947 /* 50 ~ 59 */
			964 980 996 1012 1028 1044 1060 1076 1092 1108 /* 60 ~ 69 */
			1124 1140 1156 1172 1188 1204 1220 1237 1253 1269 /* 70 ~ 79 */
			1285 1301 1317 1333 1349 1365 1381 1397 1413 1429 /* 80 ~ 89 */
			1445 1461 1477 1493 1510 1526 1542 1558 1574 1590 /* 90 ~ 99 */
			1606 1622 1638 1654 1670 1686 1702 1718 1734 1750 /* 100 ~ 109 */
			1766 1783 1799 1815 1831 1847 1863 1879 1895 1911 /* 110 ~ 119 */
			1927 1943 1959 1975 1991 2007 2023 2039 2056 2072 /* 120 ~ 129 */
			2088 2104 2120 2136 2152 2168 2184 2200 2216 2232 /* 130 ~ 139 */
			2248 2264 2280 2296 2312 2329 2345 2361 2377 2393 /* 140 ~ 149 */
			2409 2425 2441 2457 2473 2489 2505 2521 2537 2553 /* 150 ~ 159 */
			2569 2585 2602 2618 2634 2650 2666 2682 2698 2714 /* 160 ~ 169 */
			2730 2746 2762 2778 2794 2810 2826 2842 2858 2875 /* 170 ~ 179 */
			2891 2907 2923 2939 2955 2971 2987 3003 3019 3035 /* 180 ~ 189 */
			3051 3067 3083 3099 3115 3131 3148 3164 3180 3196 /* 190 ~ 199 */
			3212 3228 3244 3260 3276 3292 3308 3324 3340 3356 /* 200 ~ 209 */
			3372 3388 3404 3421 3437 3453 3469 3485 3501 3517 /* 210 ~ 219 */
			3533 3549 3565 3581 3597 3613 3629 3645 3661 3677 /* 220 ~ 229 */
			3694 3710 3726 3742 3758 3774 3790 3806 3822 3838 /* 230 ~ 239 */
			3854 3870 3886 3902 3918 3934 3950 3967 3983 3999 /* 240 ~ 249 */
			4015 4031 4047 4063 4079 4095 /* 250 ~ 255 */
		>;
	};
};
