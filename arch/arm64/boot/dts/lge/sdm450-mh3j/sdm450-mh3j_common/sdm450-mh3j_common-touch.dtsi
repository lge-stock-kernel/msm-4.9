/*
 * Copyright (c) 2018, The Linux Foundation. All rights reserved.
 *
 * This program is free software; you can redistribute it and/or modify
 * it under the terms of the GNU General Public License version 2 and
 * only version 2 as published by the Free Software Foundation.
 *
 * This program is distributed in the hope that it will be useful,
 * but WITHOUT ANY WARRANTY; without even the implied warranty of
 * MERCHANTABILITY or FITNESS FOR A PARTICULAR PURPOSE.  See the
 * GNU General Public License for more details.
 */

 &i2c_3 { /* BLSP1 QUP3 */

	status = "okay";
	qcom,clk-freq-out = <400000>;

	synaptics@20 {
		compatible = "synaptics,TD4310";
		status = "okay";

		reg = <0x20>;
		interrupt-parent = <&tlmm>;
		/* IRQF_ONESHOT				0x00002000 */
		/* IRQF_TRIGGER_FALLING		0x00000002 */
		/* IRQF_NO_SUSPEND			0x00004000 */
		interrupts = <65 0x2002>;
		irqflags = <0x2002>;
//		reset-gpio = <&tlmm 61 0x00>;
		irq-gpio = <&tlmm 65 0x2002>;

		pinctrl-names = "touch_pin_active", "touch_pin_sleep";	/* Touch GPIO pin name setting */
		pinctrl-0 = <&ts_int_active>;							/* Touch GPIO pin active setting */
		pinctrl-1 = <&ts_int_suspend>;							/* Touch GPIO pin suspend setting */

		/* Caps */
		max_x = <1080>;
		max_y = <2160>; //<1920>; // channel 30*18 -> 32*18
		max_pressure = <0xff>;
		max_width = <15>;
		max_orientation = <90>;
		max_id = <10>;
		hw_reset_delay = <150>;
		sw_reset_delay = <150>;

		/* Role */
		use_lpwg = <1>;
		use_lpwg_test = <1>;
		hide_coordinate = <1>;

		/* Firmware */
		use_fw_upgrade = <1>;
		use_firmware = <0>;
		fw_image = "touch/mh3j/synaptics/PLG673-V0.20-PR3027325-DS5.12.4.1.1015-20060114.img",
				"touch/mh3j/synaptics/PLG673-V0.20-PR3027325-DS5.12.4.1.1015-20060114-iHex.bin",
				"touch/mh3j/synaptics/PLG673-V0.02-PR2894052-DS5.12.4.1.1015-60060102.img",
				"touch/mh3j/synaptics/PLG673-V0.02-PR2894052-DS5.12.4.1.1015-60060102-iHex.bin";
		panel_spec = "touch/mh3j/synaptics/mh3j_limit.txt";
		panel_spec_mfts_folder = "touch/mh3j/synqptics/mh3j_mfts_limit.txt";

		/* ASC */
		use_asc = <0>;
		low_delta_thres = <350>;
		high_delta_thres = <600>;
		max_delta_cnt = <2>;
	};
};
