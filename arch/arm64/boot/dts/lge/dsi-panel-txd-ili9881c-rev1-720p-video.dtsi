/* Copyright (c) 2015, The Linux Foundation. All rights reserved.
 *
 * This program is free software; you can redistribute it and/or modify
 * it under the terms of the GNU General Public License version 2 and
 * only version 2 as published by the Free Software Foundation.
 *
 * This program is distributed in the hope that it will be useful,
 * but WITHOUT ANY WARRANTY; without even the implied warranty of
 * MERCHANTABILITY or FITNESS FOR A PARTICULAR PURPOSE.  See the
 * GNU General Public License for more details.
 */

&mdss_mdp {
	dsi_txd_ili9881c_rev1_720p_vid: qcom,mdss_dsi_txd_ili9881c_rev1_720p_video {
		qcom,mdss-dsi-panel-name = "txd ili9881c hd720 rev1 video mode dsi panel";
		qcom,mdss-dsi-panel-type = "dsi_video_mode";
		qcom,mdss-dsi-panel-controller = <&mdss_dsi0>;
		qcom,mdss-dsi-panel-framerate = <60>;
		qcom,mdss-dsi-virtual-channel-id = <0>;
		qcom,mdss-dsi-stream = <0>;
		qcom,mdss-dsi-panel-width = <720>;
		qcom,mdss-dsi-panel-height = <1440>;
		qcom,mdss-pan-physical-width-dimension = <62>;
		qcom,mdss-pan-physical-height-dimension = <124>;
		qcom,mdss-dsi-h-front-porch = <160>;
		qcom,mdss-dsi-h-back-porch = <140>;
		qcom,mdss-dsi-h-pulse-width = <16>;
		qcom,mdss-dsi-h-sync-skew = <0>;
		qcom,mdss-dsi-v-back-porch = <18>;
		qcom,mdss-dsi-v-front-porch = <16>;
		qcom,mdss-dsi-v-pulse-width = <4>;
		qcom,mdss-dsi-h-left-border = <0>;
		qcom,mdss-dsi-h-right-border = <0>;
		qcom,mdss-dsi-v-top-border = <0>;
		qcom,mdss-dsi-v-bottom-border = <0>;
		qcom,mdss-dsi-bpp = <24>;
		qcom,mdss-dsi-underflow-color = <0xff>;
		qcom,mdss-dsi-border-color = <0>;
		qcom,mdss-dsi-h-sync-pulse = <0>;
		qcom,mdss-dsi-traffic-mode = "burst_mode";
		qcom,mdss-dsi-bllp-eof-power-mode;
		qcom,mdss-dsi-bllp-power-mode;
		qcom,mdss-dsi-lane-0-state;
		qcom,mdss-dsi-lane-1-state;
		qcom,mdss-dsi-lane-2-state;
		qcom,mdss-dsi-lane-3-state;
		qcom,mdss-dsi-panel-timings = [
			98 22 16 00 4A 4C 1C 26 1A 03 04 00
		];
		qcom,mdss-dsi-t-clk-post = <0x04>;
		qcom,mdss-dsi-t-clk-pre = <0x1E>;
		qcom,mdss-dsi-bl-min-level = <1>;
		qcom,mdss-dsi-bl-max-level = <4095>;
		qcom,mdss-dsi-dma-trigger = "trigger_sw";
		qcom,mdss-dsi-mdp-trigger = "none";
		qcom,mdss-dsi-on-command = [
			39 01 00 00 00 00 04 FF 98 81 03
			15 01 00 00 00 00 02 01 00
			15 01 00 00 00 00 02 02 00
			15 01 00 00 00 00 02 03 73
			15 01 00 00 00 00 02 04 00
			15 01 00 00 00 00 02 05 00
			15 01 00 00 00 00 02 06 08
			15 01 00 00 00 00 02 07 00
			15 01 00 00 00 00 02 08 00
			15 01 00 00 00 00 02 09 00
			15 01 00 00 00 00 02 0a 00
			15 01 00 00 00 00 02 0b 00
			15 01 00 00 00 00 02 0c 0B
			15 01 00 00 00 00 02 0d 00
			15 01 00 00 00 00 02 0e 00
			15 01 00 00 00 00 02 0f 26
			15 01 00 00 00 00 02 10 26
			15 01 00 00 00 00 02 11 00
			15 01 00 00 00 00 02 12 00
			15 01 00 00 00 00 02 13 02
			15 01 00 00 00 00 02 14 00
			15 01 00 00 00 00 02 15 00
			15 01 00 00 00 00 02 16 00
			15 01 00 00 00 00 02 17 00
			15 01 00 00 00 00 02 18 00
			15 01 00 00 00 00 02 19 00
			15 01 00 00 00 00 02 1a 00
			15 01 00 00 00 00 02 1b 00
			15 01 00 00 00 00 02 1c 00
			15 01 00 00 00 00 02 1d 00
			15 01 00 00 00 00 02 1e 40
			15 01 00 00 00 00 02 1f C0
			15 01 00 00 00 00 02 20 06
			15 01 00 00 00 00 02 21 01
			15 01 00 00 00 00 02 22 08
			15 01 00 00 00 00 02 23 03
			15 01 00 00 00 00 02 24 8C
			15 01 00 00 00 00 02 25 8C
			15 01 00 00 00 00 02 26 00
			15 01 00 00 00 00 02 27 00
			15 01 00 00 00 00 02 28 33
			15 01 00 00 00 00 02 29 03
			15 01 00 00 00 00 02 2a 00
			15 01 00 00 00 00 02 2b 00
			15 01 00 00 00 00 02 2c 01
			15 01 00 00 00 00 02 2d 01
			15 01 00 00 00 00 02 2e 00
			15 01 00 00 00 00 02 2f 00
			15 01 00 00 00 00 02 30 00
			15 01 00 00 00 00 02 31 00
			15 01 00 00 00 00 02 32 31
			15 01 00 00 00 00 02 33 00
			15 01 00 00 00 00 02 34 23
			15 01 00 00 00 00 02 35 00
			15 01 00 00 00 00 02 36 03
			15 01 00 00 00 00 02 37 00
			15 01 00 00 00 00 02 38 00
			15 01 00 00 00 00 02 39 00
			15 01 00 00 00 00 02 3a 00
			15 01 00 00 00 00 02 3b 00
			15 01 00 00 00 00 02 3c 00
			15 01 00 00 00 00 02 3d 00
			15 01 00 00 00 00 02 3e 00
			15 01 00 00 00 00 02 3f 00
			15 01 00 00 00 00 02 40 00
			15 01 00 00 00 00 02 41 00
			15 01 00 00 00 00 02 42 00
			15 01 00 00 00 00 02 43 08
			15 01 00 00 00 00 02 44 00
			15 01 00 00 00 00 02 50 01
			15 01 00 00 00 00 02 51 23
			15 01 00 00 00 00 02 52 45
			15 01 00 00 00 00 02 53 67
			15 01 00 00 00 00 02 54 89
			15 01 00 00 00 00 02 55 ab
			15 01 00 00 00 00 02 56 01
			15 01 00 00 00 00 02 57 23
			15 01 00 00 00 00 02 58 45
			15 01 00 00 00 00 02 59 67
			15 01 00 00 00 00 02 5a 89
			15 01 00 00 00 00 02 5b ab
			15 01 00 00 00 00 02 5c cd
			15 01 00 00 00 00 02 5d ef
			15 01 00 00 00 00 02 5e 11
			15 01 00 00 00 00 02 5f 17
			15 01 00 00 00 00 02 60 00
			15 01 00 00 00 00 02 61 07
			15 01 00 00 00 00 02 62 06
			15 01 00 00 00 00 02 63 0e
			15 01 00 00 00 00 02 64 0f
			15 01 00 00 00 00 02 65 0c
			15 01 00 00 00 00 02 66 0d
			15 01 00 00 00 00 02 67 02
			15 01 00 00 00 00 02 68 02
			15 01 00 00 00 00 02 69 02
			15 01 00 00 00 00 02 6a 02
			15 01 00 00 00 00 02 6b 02
			15 01 00 00 00 00 02 6c 02
			15 01 00 00 00 00 02 6d 02
			15 01 00 00 00 00 02 6e 02
			15 01 00 00 00 00 02 6f 02
			15 01 00 00 00 00 02 70 02
			15 01 00 00 00 00 02 71 02
			15 01 00 00 00 00 02 72 02
			15 01 00 00 00 00 02 73 16
			15 01 00 00 00 00 02 74 01
			15 01 00 00 00 00 02 75 17
			15 01 00 00 00 00 02 76 00
			15 01 00 00 00 00 02 77 07
			15 01 00 00 00 00 02 78 06
			15 01 00 00 00 00 02 79 0e
			15 01 00 00 00 00 02 7a 0f
			15 01 00 00 00 00 02 7b 0c
			15 01 00 00 00 00 02 7c 0d
			15 01 00 00 00 00 02 7d 02
			15 01 00 00 00 00 02 7e 02
			15 01 00 00 00 00 02 7f 02
			15 01 00 00 00 00 02 80 02
			15 01 00 00 00 00 02 81 02
			15 01 00 00 00 00 02 82 02
			15 01 00 00 00 00 02 83 02
			15 01 00 00 00 00 02 84 02
			15 01 00 00 00 00 02 85 02
			15 01 00 00 00 00 02 86 02
			15 01 00 00 00 00 02 87 02
			15 01 00 00 00 00 02 88 02
			15 01 00 00 00 00 02 89 16
			15 01 00 00 00 00 02 8A 01
			39 01 00 00 00 00 04 FF 98 81 04
			15 01 00 00 00 00 02 00 80
			15 01 00 00 00 00 02 6C 15
			15 01 00 00 00 00 02 6E 1A
			15 01 00 00 00 00 02 6F A5
			15 01 00 00 00 00 02 8D 2A
			15 01 00 00 00 00 02 87 BA
			15 01 00 00 00 00 02 26 76
			15 01 00 00 00 00 02 B2 D1
			15 01 00 00 00 00 02 3B 98
			15 01 00 00 00 00 02 3A 92
			15 01 00 00 00 00 02 35 17
			15 01 00 00 00 00 02 B5 27
			15 01 00 00 00 00 02 31 75
			15 01 00 00 00 00 02 30 03
			15 01 00 00 00 00 02 33 14
			15 01 00 00 00 00 02 38 01
			15 01 00 00 00 00 02 39 00
			39 01 00 00 00 00 04 FF 98 81 01
			15 01 00 00 00 00 02 22 0A        
			15 01 00 00 00 00 02 2E F0
			15 01 00 00 00 00 02 31 00
			15 01 00 00 00 00 02 53 86
			15 01 00 00 00 00 02 55 8A
			15 01 00 00 00 00 02 50 E9
			15 01 00 00 00 00 02 51 E4
			15 01 00 00 00 00 02 60 14
			15 01 00 00 00 00 02 61 00
			15 01 00 00 00 00 02 62 20
			15 01 00 00 00 00 02 63 10
			15 01 00 00 00 00 02 A0 08
			15 01 00 00 00 00 02 A1 18
			15 01 00 00 00 00 02 A2 23
			15 01 00 00 00 00 02 A3 11
			15 01 00 00 00 00 02 A4 13
			15 01 00 00 00 00 02 A5 25
			15 01 00 00 00 00 02 A6 1C
			15 01 00 00 00 00 02 A7 1E
			15 01 00 00 00 00 02 A8 81
			15 01 00 00 00 00 02 A9 1C
			15 01 00 00 00 00 02 AA 27
			15 01 00 00 00 00 02 AB 79
			15 01 00 00 00 00 02 AC 1E
			15 01 00 00 00 00 02 AD 1F
			15 01 00 00 00 00 02 AE 53
			15 01 00 00 00 00 02 AF 25
			15 01 00 00 00 00 02 B0 2A
			15 01 00 00 00 00 02 B1 53
			15 01 00 00 00 00 02 B2 61
			15 01 00 00 00 00 02 B3 39
			15 01 00 00 00 00 02 C0 08
			15 01 00 00 00 00 02 C1 18
			15 01 00 00 00 00 02 C2 23
			15 01 00 00 00 00 02 C3 11
			15 01 00 00 00 00 02 C4 13
			15 01 00 00 00 00 02 C5 25
			15 01 00 00 00 00 02 C6 1C
			15 01 00 00 00 00 02 C7 1E
			15 01 00 00 00 00 02 C8 81
			15 01 00 00 00 00 02 C9 1C
			15 01 00 00 00 00 02 CA 27
			15 01 00 00 00 00 02 CB 79
			15 01 00 00 00 00 02 CC 1E
			15 01 00 00 00 00 02 CD 1F
			15 01 00 00 00 00 02 CE 53
			15 01 00 00 00 00 02 CF 25
			15 01 00 00 00 00 02 D0 2A
			15 01 00 00 00 00 02 D1 53
			15 01 00 00 00 00 02 D2 61
			15 01 00 00 00 00 02 D3 39
			39 01 00 00 00 00 04 FF 98 81 00
			15 01 00 00 00 00 02 35 00
			05 01 00 00 78 00 02 11 00
			05 01 00 00 14 00 02 29 00
			];
		qcom,mdss-dsi-off-command = [05 01 00 00 14 00 02 28 00
				 05 01 00 00 78 00 02 10 00];
		qcom,mdss-dsi-on-command-state = "dsi_lp_mode";
		qcom,mdss-dsi-off-command-state = "dsi_lp_mode";
		qcom,mdss-dsi-bl-pmic-control-type = "bl_ctrl_wled";
		qcom,mdss-dsi-reset-sequence = <1 1>, <0 1>, <1 10>;
		qcom,mdss-dsi-tx-eot-append;
		qcom,mdss-dsi-lp11-init;
		qcom,mdss-dsi-post-init-delay = <1>;
		lge,blmap-size = <256>;
		lge,blmap = <
			0 37 37 37 37 37 37 37 37 37
			37 37 38 38 38 39 39 40 40 40
			41 41 41 42 42 44 45 47 48 50
			52 53 55 56 58 59 61 64 67 70
			72 75 78 81 84 87 89 92 95 99
			103 107 111 115 120 124 128 132 136 140
			144 150 156 161 167 173 179 184 190 196
			202 207 213 220 227 234 241 248 255 261
			268 275 282 289 296 304 312 320 328 336
			344 352 360 368 376 384 392 400 410 419
			429 438 448 458 467 477 486 496 505 515
			527 539 551 563 575 587 598 610 622 634
			646 658 670 681 693 705 716 728 740 752
			763 775 787 798 810 826 841 857 872 888
			904 919 935 950 966 981 997 1013 1029 1045
			1061 1077 1093 1108 1124 1140 1156 1172 1188 1206
			1224 1242 1260 1278 1296 1315 1333 1351 1369 1387
			1405 1423 1443 1463 1482 1502 1522 1542 1561 1581
			1601 1621 1640 1660 1684 1707 1731 1754 1778 1801
			1825 1848 1872 1895 1919 1942 1968 1993 2019 2045
			2071 2096 2122 2148 2174 2199 2225 2255 2286 2316
			2347 2377 2408 2438 2468 2499 2529 2560 2590 2621
			2651 2671 2691 2712 2732 2752 2772 2792 2812 2833
			2853 2873 2893 2925 2956 2988 3020 3051 3083 3115
			3146 3178 3210 3241 3273 3307 3340 3374 3407 3441
			3474 3508 3541 3575 3608 3642
		>;
	};
};
