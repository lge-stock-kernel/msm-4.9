/* Copyright (c) 2014-2015, The Linux Foundation. All rights reserved.
 *
 * This program is free software; you can redistribute it and/or modify
 * it under the terms of the GNU General Public License version 2 and
 * only version 2 as published by the Free Software Foundation.
 *
 * This program is distributed in the hope that it will be useful,
 * but WITHOUT ANY WARRANTY; without even the implied warranty of
 * MERCHANTABILITY or FITNESS FOR A PARTICULAR PURPOSE.  See the
 * GNU General Public License for more details.
 */

/*---------------------------------------------------------------------------
 * This file is autogenerated file using gcdb parser. Please do not edit it.
 * Update input XML file to add a new entry or update variable in this file
 * VERSION = "1.0"
 *---------------------------------------------------------------------------*/
&mdss_mdp {
	dsi_boe_incell_ili9881h_hd_vid: qcom,mdss_dsi_boe_ili9881h_hd_video {
		compatible = "qcom,mdss-dsi-panel";
		status = "ok";
		qcom,cont-splash-enabled;
		qcom,mdss-dsi-panel-name = "BOE INCELL ILI9881H HD video mode dsi panel";
		qcom,mdss-dsi-panel-controller = <&mdss_dsi0>;
		qcom,mdss-dsi-panel-type = "dsi_video_mode";
		qcom,mdss-dsi-panel-destination = "display_1";
		qcom,mdss-dsi-virtual-channel-id = <0>;
		qcom,mdss-dsi-stream = <0>;
		qcom,mdss-dsi-panel-framerate = <60>;
		qcom,mdss-dsi-bpp = <24>;
		qcom,mdss-dsi-panel-width = <720>;
		qcom,mdss-dsi-panel-height = <1440>;
		qcom,mdss-dsi-h-front-porch = <68>;
		qcom,mdss-dsi-h-back-porch = <72>;
		qcom,mdss-dsi-h-pulse-width = <4>;
		qcom,mdss-dsi-h-sync-skew = <0>;
		qcom,mdss-dsi-v-front-porch = <216>;
		qcom,mdss-dsi-v-back-porch = <20>;
		qcom,mdss-dsi-v-pulse-width = <4>;

		qcom,mdss-dsi-h-left-border = <0>;
		qcom,mdss-dsi-h-right-border = <0>;
		qcom,mdss-dsi-v-top-border = <0>;
		qcom,mdss-dsi-v-bottom-border = <0>;

		qcom,mdss-dsi-underflow-color = <0xff>;
		qcom,mdss-dsi-border-color = <0>;

		qcom,mdss-pan-physical-width-dimension = <64>;
		qcom,mdss-pan-physical-height-dimension = <129>;

		qcom,mdss-dsi-on-command = [
			29 01 00 00 00 00 04 FF 98 81 01
			29 01 00 00 00 00 02 2D 60
			29 01 00 00 00 00 02 00 48
			29 01 00 00 00 00 02 01 33
			29 01 00 00 00 00 02 02 97
			29 01 00 00 00 00 02 03 05
			29 01 00 00 00 00 02 08 86
			29 01 00 00 00 00 02 09 01
			29 01 00 00 00 00 02 0a 73
			29 01 00 00 00 00 02 0b 00
			29 01 00 00 00 00 02 0c ff
			29 01 00 00 00 00 02 0d ff
			29 01 00 00 00 00 02 0e 05
			29 01 00 00 00 00 02 0f 05
			29 01 00 00 00 00 02 12 06
			29 01 00 00 00 00 02 28 48
			29 01 00 00 00 00 02 29 86
			29 01 00 00 00 00 02 31 07
			29 01 00 00 00 00 02 32 02    //GCL_R
			29 01 00 00 00 00 02 33 00    //VSD_R
			29 01 00 00 00 00 02 34 15    //CLK2
			29 01 00 00 00 00 02 35 17    //CLK4
			29 01 00 00 00 00 02 36 11    //CLK6
			29 01 00 00 00 00 02 37 13    //CLK8
			29 01 00 00 00 00 02 38 2a    //VGL_R
			29 01 00 00 00 00 02 39 06    //GCH_R
			29 01 00 00 00 00 02 3a 01    //VDS_R
			29 01 00 00 00 00 02 3b 09    //STV2
			29 01 00 00 00 00 02 3c 0b    //STV4
			29 01 00 00 00 00 02 3d 07
			29 01 00 00 00 00 02 3e 07
			29 01 00 00 00 00 02 3f 07
			29 01 00 00 00 00 02 40 07
			29 01 00 00 00 00 02 41 07
			29 01 00 00 00 00 02 42 07
			29 01 00 00 00 00 02 43 07
			29 01 00 00 00 00 02 44 07
			29 01 00 00 00 00 02 45 07
			29 01 00 00 00 00 02 46 07
			29 01 00 00 00 00 02 47 07
			29 01 00 00 00 00 02 48 02      //GCL_L
			29 01 00 00 00 00 02 49 00      //VSD_L
			29 01 00 00 00 00 02 4a 14      //CLK1
			29 01 00 00 00 00 02 4b 16      //CLK3
			29 01 00 00 00 00 02 4c 10      //CLK5
			29 01 00 00 00 00 02 4d 12      //CLK7
			29 01 00 00 00 00 02 4e 2a      //VGL_L
			29 01 00 00 00 00 02 4f 06      //GCH_L
			29 01 00 00 00 00 02 50 01      //VDS_L
			29 01 00 00 00 00 02 51 08      //STV1
			29 01 00 00 00 00 02 52 0a      //STV3
			29 01 00 00 00 00 02 53 07
			29 01 00 00 00 00 02 54 07
			29 01 00 00 00 00 02 55 07
			29 01 00 00 00 00 02 56 07
			29 01 00 00 00 00 02 57 07
			29 01 00 00 00 00 02 58 07
			29 01 00 00 00 00 02 59 07
			29 01 00 00 00 00 02 5a 07
			29 01 00 00 00 00 02 5b 07
			29 01 00 00 00 00 02 5c 07
			29 01 00 00 00 00 02 61 07
			29 01 00 00 00 00 02 62 02
			29 01 00 00 00 00 02 63 00
			29 01 00 00 00 00 02 64 12
			29 01 00 00 00 00 02 65 10
			29 01 00 00 00 00 02 66 16
			29 01 00 00 00 00 02 67 14
			29 01 00 00 00 00 02 68 2a
			29 01 00 00 00 00 02 69 06       //GCH_R  BW
			29 01 00 00 00 00 02 6a 01
			29 01 00 00 00 00 02 6b 0a
			29 01 00 00 00 00 02 6c 08
			29 01 00 00 00 00 02 6d 07
			29 01 00 00 00 00 02 6e 07
			29 01 00 00 00 00 02 6f 07
			29 01 00 00 00 00 02 70 07
			29 01 00 00 00 00 02 71 07
			29 01 00 00 00 00 02 72 07
			29 01 00 00 00 00 02 73 07
			29 01 00 00 00 00 02 74 07
			29 01 00 00 00 00 02 75 07
			29 01 00 00 00 00 02 76 07
			29 01 00 00 00 00 02 77 07
			29 01 00 00 00 00 02 78 02
			29 01 00 00 00 00 02 79 00
			29 01 00 00 00 00 02 7a 13
			29 01 00 00 00 00 02 7b 11
			29 01 00 00 00 00 02 7c 17
			29 01 00 00 00 00 02 7d 15
			29 01 00 00 00 00 02 7e 2a
			29 01 00 00 00 00 02 7f 06       //GCH_L  BW
			29 01 00 00 00 00 02 80 01
			29 01 00 00 00 00 02 81 0b
			29 01 00 00 00 00 02 82 09
			29 01 00 00 00 00 02 83 07
			29 01 00 00 00 00 02 84 07
			29 01 00 00 00 00 02 85 07
			29 01 00 00 00 00 02 86 07
			29 01 00 00 00 00 02 87 07
			29 01 00 00 00 00 02 88 07
			29 01 00 00 00 00 02 89 07
			29 01 00 00 00 00 02 8a 07
			29 01 00 00 00 00 02 8b 07
			29 01 00 00 00 00 02 8c 07
			29 01 00 00 00 00 02 a0 01
			29 01 00 00 00 00 02 a1 82
			29 01 00 00 00 00 02 a2 25
			29 01 00 00 00 00 02 a7 82
			29 01 00 00 00 00 02 a8 82
			29 01 00 00 00 00 02 a9 25
			29 01 00 00 00 00 02 aa 25
			29 01 00 00 00 00 02 b0 34
			29 01 00 00 00 00 02 b2 04
			29 01 00 00 00 00 02 b9 00	//20
			29 01 00 00 00 00 02 ba 01
			29 01 00 00 00 00 02 c1 10
			29 01 00 00 00 00 02 d0 01
			29 01 00 00 00 00 02 d1 00
			29 01 00 00 00 00 02 e2 00
			29 01 00 00 00 00 02 e6 22
			29 01 00 00 00 00 02 ea 00
			29 01 00 00 00 00 02 FC 09 //VHsync
			29 01 00 00 00 00 04 FF 98 81 02
			29 01 00 00 00 00 02 5B 00
			29 01 00 00 00 00 02 0B 00
			29 01 00 00 00 00 02 4D 4E
			29 01 00 00 00 00 02 4E 00
			29 01 00 00 00 00 04 FF 98 81 05
			29 01 00 00 00 00 02 63 97 //GVDDN  5.5V
			29 01 00 00 00 00 02 64 97 //GVDDP  -5.5V
			29 01 00 00 00 00 02 68 65 //VGHO   12V
			29 01 00 00 00 00 02 69 7F //VGH
			29 01 00 00 00 00 02 6A C9 //VGLO  -14V  D3
			29 01 00 00 00 00 02 6B CF //VGL
			29 01 00 00 00 00 04 FF 98 81 08
			29 01 00 00 00 00 1C E0 00 24 4D 6F A0 50 CC F1 21 48 95 89 BF F2 22 AA 54 8E B3 E0 FF 06 36 6F 9F 03 EC
			29 01 00 00 00 00 1C E1 00 24 4D 6F A0 50 CC F1 21 48 95 89 BF F2 22 AA 54 8E B3 E0 FF 06 36 6F 9F 03 EC
			29 01 00 00 00 00 04 FF 98 81 06
			29 01 00 00 00 00 02 C2 04
			29 01 00 00 00 00 02 D6 85
			29 01 00 00 00 00 02 D2 01
			29 01 00 00 00 00 02 D1 01
			29 01 00 00 00 00 02 D0 4A
			29 01 00 00 00 00 02 11 03
			29 01 00 00 00 00 02 13 45  //+0.25%
			29 01 00 00 00 00 02 14 41
			29 01 00 00 00 00 02 15 F1  //-0.25%
			29 01 00 00 00 00 02 16 40
			29 01 00 00 00 00 02 17 48
			29 01 00 00 00 00 02 18 3B
			29 01 00 00 00 00 04 FF 98 81 0E
			29 01 00 00 00 00 02 11 90
			29 01 00 00 00 00 02 13 0A
			29 01 00 00 00 00 02 00 A0
			29 01 00 00 00 00 04 FF 98 81 04   // CE enable
			29 01 00 00 00 00 02 02 41  //CE AXIS_EN
			29 01 00 00 00 00 02 0A 09  //SE_RATIO_00  0.2815
			29 01 00 00 00 00 02 0B 09  //SE_RATIO_01  0.2815
			29 01 00 00 00 00 02 0C 09  //SE_RATIO_02  0.2815
			29 01 00 00 00 00 02 0D 08  //SE_RATIO_03  0.25
			29 01 00 00 00 00 02 0E 07  //SE_RATIO_04  0.21875
			29 01 00 00 00 00 02 0F 07  //SE_RATIO_05  0.21875
			29 01 00 00 00 00 02 10 08  //SE_RATIO_06  0.25
			29 01 00 00 00 00 02 11 09  //SE_RATIO_07  0.2815
			29 01 00 00 00 00 02 12 09  //SE_RATIO_08  0.2815
			29 01 00 00 00 00 02 13 09  //SE_RATIO_09  0.2815
			29 01 00 00 00 00 02 14 09  //SE_RATIO_10  0.2815
			29 01 00 00 00 00 02 15 09  //SE_RATIO_11  0.2815
			29 01 00 00 00 00 02 16 09  //SE_RATIO_12  0.2815
			29 01 00 00 00 00 02 17 09  //SE_RATIO_13  0.2815
			29 01 00 00 00 00 02 18 09  //SE_RATIO_14  0.2815
			29 01 00 00 00 00 02 19 09  //SE_RATIO_15  0.2815
			29 01 00 00 00 00 02 1A 09  //SE_RATIO_16  0.2815
			29 01 00 00 00 00 02 1B 09  //SE_RATIO_17  0.2815
			29 01 00 00 00 00 02 1C 09  //SE_RATIO_18  0.2815
			29 01 00 00 00 00 02 1D 09  //SE_RATIO_19  0.2815
			29 01 00 00 00 00 02 1E 09  //SE_RATIO_20  0.2815
			29 01 00 00 00 00 02 1F 09  //SE_RATIO_21  0.2815
			29 01 00 00 00 00 02 20 09  //SE_RATIO_22  0.2815
			29 01 00 00 00 00 02 21 09  //SE_RATIO_23  0.2815
			29 01 00 00 00 00 04 FF 98 81 03
			29 01 00 00 00 00 02 81 03 //CABC dimming step 8; each stpe 1 frame
			29 01 00 00 00 00 02 83 60
			29 01 00 00 00 00 02 84 03
			29 01 00 00 00 00 02 89 A0 //CABC high saturation setting
			29 01 00 00 00 00 02 AE CB //80%
			29 01 00 00 00 00 02 94 08 //CABC medium mode adjust
			29 01 00 00 00 00 02 95 0C //CABC medium mode adjust
			29 01 00 00 00 00 02 96 0E //CABC medium mode adjust
			29 01 00 00 00 00 02 97 10 //CABC medium mode adjust
			29 01 00 00 00 00 02 98 12 //CABC medium mode adjust
			29 01 00 00 00 00 02 99 13 //CABC medium mode adjust
			29 01 00 00 00 00 02 9A 14 //CABC medium mode adjust
			29 01 00 00 00 00 02 9B 15 //CABC medium mode adjust
			29 01 00 00 00 00 02 9C 16 //CABC medium mode adjust
			29 01 00 00 00 00 02 9D 16 //CABC medium mode adjust
			29 01 00 00 00 00 04 FF 98 81 00 //Page0
			29 01 00 00 00 00 03 51 0F F0
			29 01 00 00 00 00 02 55 02
			29 01 00 00 00 00 02 53 2C
			05 01 00 00 78 00 02 11 00
			05 01 00 00 14 00 02 29 00
		];
		qcom,mdss-dsi-off-command = [
			05 01 00 00 14 00 02 28 00
			05 01 00 00 78 00 02 10 00
		];

		lge,mdss-dsi-extra-command-names = "lpwg-on";

		lge,mdss-dsi-extra-command-lpwg-on = [
			29 01 00 00 00 00 04 FF 98 81 01
			29 01 00 00 00 00 02 2D 60
			29 01 00 00 00 00 02 00 48
			29 01 00 00 00 00 02 01 33
			29 01 00 00 00 00 02 02 97
			29 01 00 00 00 00 02 03 05
			29 01 00 00 00 00 02 08 86
			29 01 00 00 00 00 02 09 01
			29 01 00 00 00 00 02 0a 73
			29 01 00 00 00 00 02 0b 00
			29 01 00 00 00 00 02 0c ff
			29 01 00 00 00 00 02 0d ff
			29 01 00 00 00 00 02 0e 05
			29 01 00 00 00 00 02 0f 05
			29 01 00 00 00 00 02 12 06
			29 01 00 00 00 00 02 28 48
			29 01 00 00 00 00 02 29 86
			29 01 00 00 00 00 02 31 07
			29 01 00 00 00 00 02 32 02    //GCL_R
			29 01 00 00 00 00 02 33 00    //VSD_R
			29 01 00 00 00 00 02 34 15    //CLK2
			29 01 00 00 00 00 02 35 17    //CLK4
			29 01 00 00 00 00 02 36 11    //CLK6
			29 01 00 00 00 00 02 37 13    //CLK8
			29 01 00 00 00 00 02 38 2a    //VGL_R
			29 01 00 00 00 00 02 39 06    //GCH_R
			29 01 00 00 00 00 02 3a 01    //VDS_R
			29 01 00 00 00 00 02 3b 09    //STV2
			29 01 00 00 00 00 02 3c 0b    //STV4
			29 01 00 00 00 00 02 3d 07
			29 01 00 00 00 00 02 3e 07
			29 01 00 00 00 00 02 3f 07
			29 01 00 00 00 00 02 40 07
			29 01 00 00 00 00 02 41 07
			29 01 00 00 00 00 02 42 07
			29 01 00 00 00 00 02 43 07
			29 01 00 00 00 00 02 44 07
			29 01 00 00 00 00 02 45 07
			29 01 00 00 00 00 02 46 07
			29 01 00 00 00 00 02 47 07
			29 01 00 00 00 00 02 48 02      //GCL_L
			29 01 00 00 00 00 02 49 00      //VSD_L
			29 01 00 00 00 00 02 4a 14      //CLK1
			29 01 00 00 00 00 02 4b 16      //CLK3
			29 01 00 00 00 00 02 4c 10      //CLK5
			29 01 00 00 00 00 02 4d 12      //CLK7
			29 01 00 00 00 00 02 4e 2a      //VGL_L
			29 01 00 00 00 00 02 4f 06      //GCH_L
			29 01 00 00 00 00 02 50 01      //VDS_L
			29 01 00 00 00 00 02 51 08      //STV1
			29 01 00 00 00 00 02 52 0a      //STV3
			29 01 00 00 00 00 02 53 07
			29 01 00 00 00 00 02 54 07
			29 01 00 00 00 00 02 55 07
			29 01 00 00 00 00 02 56 07
			29 01 00 00 00 00 02 57 07
			29 01 00 00 00 00 02 58 07
			29 01 00 00 00 00 02 59 07
			29 01 00 00 00 00 02 5a 07
			29 01 00 00 00 00 02 5b 07
			29 01 00 00 00 00 02 5c 07
			29 01 00 00 00 00 02 61 07
			29 01 00 00 00 00 02 62 02
			29 01 00 00 00 00 02 63 00
			29 01 00 00 00 00 02 64 12
			29 01 00 00 00 00 02 65 10
			29 01 00 00 00 00 02 66 16
			29 01 00 00 00 00 02 67 14
			29 01 00 00 00 00 02 68 2a
			29 01 00 00 00 00 02 69 06       //GCH_R  BW
			29 01 00 00 00 00 02 6a 01
			29 01 00 00 00 00 02 6b 0a
			29 01 00 00 00 00 02 6c 08
			29 01 00 00 00 00 02 6d 07
			29 01 00 00 00 00 02 6e 07
			29 01 00 00 00 00 02 6f 07
			29 01 00 00 00 00 02 70 07
			29 01 00 00 00 00 02 71 07
			29 01 00 00 00 00 02 72 07
			29 01 00 00 00 00 02 73 07
			29 01 00 00 00 00 02 74 07
			29 01 00 00 00 00 02 75 07
			29 01 00 00 00 00 02 76 07
			29 01 00 00 00 00 02 77 07
			29 01 00 00 00 00 02 78 02
			29 01 00 00 00 00 02 79 00
			29 01 00 00 00 00 02 7a 13
			29 01 00 00 00 00 02 7b 11
			29 01 00 00 00 00 02 7c 17
			29 01 00 00 00 00 02 7d 15
			29 01 00 00 00 00 02 7e 2a
			29 01 00 00 00 00 02 7f 06       //GCH_L  BW
			29 01 00 00 00 00 02 80 01
			29 01 00 00 00 00 02 81 0b
			29 01 00 00 00 00 02 82 09
			29 01 00 00 00 00 02 83 07
			29 01 00 00 00 00 02 84 07
			29 01 00 00 00 00 02 85 07
			29 01 00 00 00 00 02 86 07
			29 01 00 00 00 00 02 87 07
			29 01 00 00 00 00 02 88 07
			29 01 00 00 00 00 02 89 07
			29 01 00 00 00 00 02 8a 07
			29 01 00 00 00 00 02 8b 07
			29 01 00 00 00 00 02 8c 07
			29 01 00 00 00 00 02 a0 01
			29 01 00 00 00 00 02 a1 82
			29 01 00 00 00 00 02 a2 25
			29 01 00 00 00 00 02 a7 82
			29 01 00 00 00 00 02 a8 82
			29 01 00 00 00 00 02 a9 25
			29 01 00 00 00 00 02 aa 25
			29 01 00 00 00 00 02 b0 34
			29 01 00 00 00 00 02 b2 04
			29 01 00 00 00 00 02 b9 00	//20
			29 01 00 00 00 00 02 ba 01
			29 01 00 00 00 00 02 c1 10
			29 01 00 00 00 00 02 d0 01
			29 01 00 00 00 00 02 d1 00
			29 01 00 00 00 00 02 e2 00
			29 01 00 00 00 00 02 e6 22
			29 01 00 00 00 00 02 ea 00
			29 01 00 00 00 00 02 FC 09 //VHsync
			29 01 00 00 00 00 04 FF 98 81 02
			29 01 00 00 00 00 02 5B 00
			29 01 00 00 00 00 02 0B 00
			29 01 00 00 00 00 02 4D 4E
			29 01 00 00 00 00 02 4E 00
			29 01 00 00 00 00 04 FF 98 81 05
			29 01 00 00 00 00 02 63 97 //GVDDN  5.5V
			29 01 00 00 00 00 02 64 97 //GVDDP  -5.5V
			29 01 00 00 00 00 02 68 65 //VGHO   12V
			29 01 00 00 00 00 02 69 7F //VGH
			29 01 00 00 00 00 02 6A C9 //VGLO  -14V  D3
			29 01 00 00 00 00 02 6B CF //VGL
			29 01 00 00 00 00 04 FF 98 81 08
			29 01 00 00 00 00 1C E0 00 24 4D 6F A0 50 CC F1 21 48 95 89 BF F2 22 AA 54 8E B3 E0 FF 06 36 6F 9F 03 EC
			29 01 00 00 00 00 1C E1 00 24 4D 6F A0 50 CC F1 21 48 95 89 BF F2 22 AA 54 8E B3 E0 FF 06 36 6F 9F 03 EC
			29 01 00 00 00 00 04 FF 98 81 06
			29 01 00 00 00 00 02 C2 04
			29 01 00 00 00 00 02 D6 85
			29 01 00 00 00 00 02 D2 01
			29 01 00 00 00 00 02 D1 01
			29 01 00 00 00 00 02 D0 4A
			29 01 00 00 00 00 02 11 03
			29 01 00 00 00 00 02 13 45  //+0.25%
			29 01 00 00 00 00 02 14 41
			29 01 00 00 00 00 02 15 F1  //-0.25%
			29 01 00 00 00 00 02 16 40
			29 01 00 00 00 00 02 17 48
			29 01 00 00 00 00 02 18 3B
			29 01 00 00 00 00 04 FF 98 81 0E
			29 01 00 00 00 00 02 11 90
			29 01 00 00 00 00 02 13 0A
			29 01 00 00 00 00 02 00 A0
			29 01 00 00 00 00 04 FF 98 81 04   // CE enable
			29 01 00 00 00 00 02 02 41  //CE AXIS_EN
			29 01 00 00 00 00 02 0A 09  //SE_RATIO_00  0.2815
			29 01 00 00 00 00 02 0B 09  //SE_RATIO_01  0.2815
			29 01 00 00 00 00 02 0C 09  //SE_RATIO_02  0.2815
			29 01 00 00 00 00 02 0D 08  //SE_RATIO_03  0.25
			29 01 00 00 00 00 02 0E 07  //SE_RATIO_04  0.21875
			29 01 00 00 00 00 02 0F 07  //SE_RATIO_05  0.21875
			29 01 00 00 00 00 02 10 08  //SE_RATIO_06  0.25
			29 01 00 00 00 00 02 11 09  //SE_RATIO_07  0.2815
			29 01 00 00 00 00 02 12 09  //SE_RATIO_08  0.2815
			29 01 00 00 00 00 02 13 09  //SE_RATIO_09  0.2815
			29 01 00 00 00 00 02 14 09  //SE_RATIO_10  0.2815
			29 01 00 00 00 00 02 15 09  //SE_RATIO_11  0.2815
			29 01 00 00 00 00 02 16 09  //SE_RATIO_12  0.2815
			29 01 00 00 00 00 02 17 09  //SE_RATIO_13  0.2815
			29 01 00 00 00 00 02 18 09  //SE_RATIO_14  0.2815
			29 01 00 00 00 00 02 19 09  //SE_RATIO_15  0.2815
			29 01 00 00 00 00 02 1A 09  //SE_RATIO_16  0.2815
			29 01 00 00 00 00 02 1B 09  //SE_RATIO_17  0.2815
			29 01 00 00 00 00 02 1C 09  //SE_RATIO_18  0.2815
			29 01 00 00 00 00 02 1D 09  //SE_RATIO_19  0.2815
			29 01 00 00 00 00 02 1E 09  //SE_RATIO_20  0.2815
			29 01 00 00 00 00 02 1F 09  //SE_RATIO_21  0.2815
			29 01 00 00 00 00 02 20 09  //SE_RATIO_22  0.2815
			29 01 00 00 00 00 02 21 09  //SE_RATIO_23  0.2815
			29 01 00 00 00 00 04 FF 98 81 03
			29 01 00 00 00 00 02 81 03 //CABC dimming step 8; each stpe 1 frame
			29 01 00 00 00 00 02 83 60
			29 01 00 00 00 00 02 84 03
			29 01 00 00 00 00 02 89 A0 //CABC high saturation setting
			29 01 00 00 00 00 02 AE CB //80%
			29 01 00 00 00 00 02 94 08 //CABC medium mode adjust
			29 01 00 00 00 00 02 95 0C //CABC medium mode adjust
			29 01 00 00 00 00 02 96 0E //CABC medium mode adjust
			29 01 00 00 00 00 02 97 10 //CABC medium mode adjust
			29 01 00 00 00 00 02 98 12 //CABC medium mode adjust
			29 01 00 00 00 00 02 99 13 //CABC medium mode adjust
			29 01 00 00 00 00 02 9A 14 //CABC medium mode adjust
			29 01 00 00 00 00 02 9B 15 //CABC medium mode adjust
			29 01 00 00 00 00 02 9C 16 //CABC medium mode adjust
			29 01 00 00 00 00 02 9D 16 //CABC medium mode adjust
			29 01 00 00 00 00 04 FF 98 81 00 //Page0
			29 01 00 00 00 00 03 51 0F F0
		  	29 01 00 00 00 00 02 55 02
			29 01 00 00 00 00 02 53 2C
		];
		lge,mdss-dsi-extra-command-state-lpwg-on = "dsi_lp_mode";

		qcom,mdss-dsi-on-command-state = "dsi_lp_mode";
		qcom,mdss-dsi-off-command-state = "dsi_lp_mode";
		qcom,mdss-dsi-reset-sequence = <0 2>, <1 120>;
		qcom,mdss-dsi-lp11-init;
		qcom,mdss-dsi-post-init-delay = <4>;
		qcom,mdss-dsi-h-sync-pulse = <1>;
		qcom,mdss-dsi-traffic-mode = "non_burst_sync_pulse";
		qcom,mdss-dsi-lane-map = "lane_map_0123";
		qcom,mdss-dsi-dma-trigger = "trigger_sw";
		qcom,mdss-dsi-mdp-trigger = "none";
		qcom,mdss-dsi-color-order = "rgb_swap_rgb";
		qcom,mdss-dsi-bllp-eof-power-mode;
		qcom,mdss-dsi-bllp-power-mode;
		qcom,mdss-dsi-tx-eot-append;
		qcom,suspend-ulps-enabled;
		qcom,mdss-dsi-lane-0-state;
		qcom,mdss-dsi-lane-1-state;
		qcom,mdss-dsi-lane-2-state;
		qcom,mdss-dsi-lane-3-state;

		qcom,mdss-dsi-panel-timings-phy-v2 = [
			1F 1C 05 06 03 03 04 a0
			1F 1C 05 06 03 03 04 a0
			1F 1C 05 06 03 03 04 a0
			1F 1C 05 06 03 03 04 a0
			1F 10 05 06 03 03 04 a0
		];
		qcom,mdss-dsi-t-clk-post = <0x0B>;
		qcom,mdss-dsi-t-clk-pre = <0x22>;

		qcom,mdss-dsi-bl-min-level = <1>;
		qcom,mdss-dsi-bl-max-level = <255>;

		lge,blmap-size = <256>;
		lge,blmap = <
			0 27 27 27 27 27 27 27 27 27 /* 0 ~ 9 */
			27 27 28 28 29 29 30 31 32 33 /* 10 ~ 19 */
			34 35 36 37 38 39 40 41 42 43 /* 20 ~ 29 */
			44 46 48 50 52 54 56 58 60 62 /* 30 ~ 39 */
			64 66 68 70 72 74 76 78 80 81 /* 40 ~ 49 */
			84 90 96 102 108 114 120 126 126 126 /* 50 ~ 59 */
			126 126 126 131 136 141 146 151 156 161 /* 60 ~ 69 */
			166 171 176 181 186 192 198 204 210 216 /* 70 ~ 79 */
			222 228 234 240 246 253 260 267 274 281 /* 80 ~ 89 */
			288 295 302 309 316 323 330 337 344 351 /* 90 ~ 99 */
			358 365 372 380 388 396 404 412 420 429 /* 100 ~ 109 */
			438 447 456 465 474 483 492 501 511 521 /* 110 ~ 119 */
			531 541 552 563 574 585 596 607 618 629 /* 120 ~ 129 */
			640 651 663 675 704 733 752 771 791 820 /* 130 ~ 139 */
			849 868 887 907 917 927 931 936 941 948 /* 140 ~ 149 */
			955 959 964 969 975 982 988 995 1013 1030 /* 150 ~ 159 */
			1047 1064 1081 1098 1115 1132 1149 1166 1183 1200 /* 160 ~ 169 */
			1218 1236 1254 1272 1290 1308 1326 1344 1362 1381 /* 170 ~ 179 */
			1400 1419 1438 1457 1476 1495 1515 1535 1555 1575 /* 180 ~ 189 */
			1595 1615 1635 1655 1675 1695 1715 1735 1755 1775 /* 190 ~ 199 */
			1795 1815 1835 1856 1877 1898 1919 1940 1965 1990 /* 200 ~ 209 */
			2015 2040 2065 2091 2117 2143 2169 2195 2221 2247 /* 210 ~ 219 */
			2271 2295 2319 2343 2367 2392 2417 2442 2467 2492 /* 220 ~ 229 */
			2517 2542 2567 2596 2625 2654 2683 2712 2741 2770 /* 230 ~ 239 */
			2800 2830 2860 2890 2920 2952 2984 3016 3048 3080 /* 240 ~ 249 */
			3112 3144 3177 3210 3243 3276 /* 250 ~ 255 */
		>;

		lge,cabc-status = <1>; // HW_REV_1_0
	};
};
